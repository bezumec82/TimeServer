# file: GreenThreads_H757.ioc
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CortexM4.IPs=FATFS_M4\:I,FREERTOS_M4\:I,IWDG2\:I,RCC,USB_DEVICE_M4\:I,USB_HOST_M4\:I,WWDG2\:I,DMA,BDMA,MDMA,NVIC2\:I,DEBUG,PDM2PCM_M4\:I,PWR,RESMGR_UTILITY,SYS_M4\:I,CORTEX_M4\:I,VREFBUF
CortexM7.IPs=FATFS_M7\:I,FREERTOS_M7\:I,IWDG1\:I,RCC\:I,USB_DEVICE_M7\:I,USB_HOST_M7\:I,WWDG1\:I,DMA\:I,BDMA\:I,MDMA\:I,NVIC1\:I,FMC\:I,I2C1\:I,LTDC\:I,DSIHOST\:I,SYS\:I,USART1\:I,USB_OTG_FS\:I,USB_OTG_HS\:I,CORTEX_M7\:I,DEBUG\:I,ETH\:I,PDM2PCM_M7\:I,PWR\:I,RESMGR_UTILITY\:I,VREFBUF\:I,SPI5\:I,UART4\:I,UART5\:I,UART8\:I,USART3\:I,USART6\:I
CortexM7.Pins=PK5,PK4,PK6,PK3,PA10,PC13,PG7,PK2
DSI_CKN.Mode=DSIHost_Adapted_TE
DSI_CKN.PinAttribute=CortexM7
DSI_CKN.Signal=DSIHOST_CKN
DSI_CKP.Mode=DSIHost_Adapted_TE
DSI_CKP.PinAttribute=CortexM7
DSI_CKP.Signal=DSIHOST_CKP
DSI_D0N.Mode=DSIHost_Adapted_TE
DSI_D0N.PinAttribute=CortexM7
DSI_D0N.Signal=DSIHOST_D0N
DSI_D0P.Mode=DSIHost_Adapted_TE
DSI_D0P.PinAttribute=CortexM7
DSI_D0P.Signal=DSIHOST_D0P
DSI_D1N.Mode=DSIHost_Adapted_TE
DSI_D1N.PinAttribute=CortexM7
DSI_D1N.Signal=DSIHOST_D1N
DSI_D1P.Mode=DSIHost_Adapted_TE
DSI_D1P.PinAttribute=CortexM7
DSI_D1P.Signal=DSIHOST_D1P
Dma.Request0=UART4_RX
Dma.Request1=UART4_TX
Dma.Request10=USART6_RX
Dma.Request11=USART6_TX
Dma.Request2=UART5_RX
Dma.Request3=UART5_TX
Dma.Request4=UART8_RX
Dma.Request5=UART8_TX
Dma.Request6=USART1_RX
Dma.Request7=USART1_TX
Dma.Request8=USART3_RX
Dma.Request9=USART3_TX
Dma.UART4_RX.0.Direction=DMA_PERIPH_TO_MEMORY
Dma.UART4_RX.0.EventEnable=DISABLE
Dma.UART4_RX.0.FIFOMode=DMA_FIFOMODE_DISABLE
Dma.UART4_RX.0.Instance=DMA1_Stream0
Dma.UART4_RX.0.MemDataAlignment=DMA_MDATAALIGN_BYTE
Dma.UART4_RX.0.MemInc=DMA_MINC_ENABLE
Dma.UART4_RX.0.Mode=DMA_NORMAL
Dma.UART4_RX.0.PeriphDataAlignment=DMA_PDATAALIGN_BYTE
Dma.UART4_RX.0.PeriphInc=DMA_PINC_DISABLE
Dma.UART4_RX.0.Polarity=HAL_DMAMUX_REQ_GEN_RISING
Dma.UART4_RX.0.Priority=DMA_PRIORITY_LOW
Dma.UART4_RX.0.RequestNumber=1
Dma.UART4_RX.0.SignalID=NONE
Dma.UART4_RX.0.SyncEnable=DISABLE
Dma.UART4_RX.0.SyncPolarity=HAL_DMAMUX_SYNC_NO_EVENT
Dma.UART4_RX.0.SyncRequestNumber=1
Dma.UART4_RX.0.SyncSignalID=NONE
Dma.UART4_TX.1.Direction=DMA_MEMORY_TO_PERIPH
Dma.UART4_TX.1.EventEnable=DISABLE
Dma.UART4_TX.1.FIFOMode=DMA_FIFOMODE_DISABLE
Dma.UART4_TX.1.Instance=DMA1_Stream1
Dma.UART4_TX.1.MemDataAlignment=DMA_MDATAALIGN_BYTE
Dma.UART4_TX.1.MemInc=DMA_MINC_ENABLE
Dma.UART4_TX.1.Mode=DMA_NORMAL
Dma.UART4_TX.1.PeriphDataAlignment=DMA_PDATAALIGN_BYTE
Dma.UART4_TX.1.PeriphInc=DMA_PINC_DISABLE
Dma.UART4_TX.1.Polarity=HAL_DMAMUX_REQ_GEN_RISING
Dma.UART4_TX.1.Priority=DMA_PRIORITY_LOW
Dma.UART4_TX.1.RequestNumber=1
Dma.UART4_TX.1.SignalID=NONE
Dma.UART4_TX.1.SyncEnable=DISABLE
Dma.UART4_TX.1.SyncPolarity=HAL_DMAMUX_SYNC_NO_EVENT
Dma.UART4_TX.1.SyncRequestNumber=1
Dma.UART4_TX.1.SyncSignalID=NONE
Dma.UART5_RX.2.Direction=DMA_PERIPH_TO_MEMORY
Dma.UART5_RX.2.EventEnable=DISABLE
Dma.UART5_RX.2.FIFOMode=DMA_FIFOMODE_DISABLE
Dma.UART5_RX.2.Instance=DMA1_Stream2
Dma.UART5_RX.2.MemDataAlignment=DMA_MDATAALIGN_BYTE
Dma.UART5_RX.2.MemInc=DMA_MINC_ENABLE
Dma.UART5_RX.2.Mode=DMA_NORMAL
Dma.UART5_RX.2.PeriphDataAlignment=DMA_PDATAALIGN_BYTE
Dma.UART5_RX.2.PeriphInc=DMA_PINC_DISABLE
Dma.UART5_RX.2.Polarity=HAL_DMAMUX_REQ_GEN_RISING
Dma.UART5_RX.2.Priority=DMA_PRIORITY_LOW
Dma.UART5_RX.2.RequestNumber=1
Dma.UART5_RX.2.SignalID=NONE
Dma.UART5_RX.2.SyncEnable=DISABLE
Dma.UART5_RX.2.SyncPolarity=HAL_DMAMUX_SYNC_NO_EVENT
Dma.UART5_RX.2.SyncRequestNumber=1
Dma.UART5_RX.2.SyncSignalID=NONE
Dma.UART5_TX.3.Direction=DMA_MEMORY_TO_PERIPH
Dma.UART5_TX.3.EventEnable=DISABLE
Dma.UART5_TX.3.FIFOMode=DMA_FIFOMODE_DISABLE
Dma.UART5_TX.3.Instance=DMA1_Stream3
Dma.UART5_TX.3.MemDataAlignment=DMA_MDATAALIGN_BYTE
Dma.UART5_TX.3.MemInc=DMA_MINC_ENABLE
Dma.UART5_TX.3.Mode=DMA_NORMAL
Dma.UART5_TX.3.PeriphDataAlignment=DMA_PDATAALIGN_BYTE
Dma.UART5_TX.3.PeriphInc=DMA_PINC_DISABLE
Dma.UART5_TX.3.Polarity=HAL_DMAMUX_REQ_GEN_RISING
Dma.UART5_TX.3.Priority=DMA_PRIORITY_LOW
Dma.UART5_TX.3.RequestNumber=1
Dma.UART5_TX.3.SignalID=NONE
Dma.UART5_TX.3.SyncEnable=DISABLE
Dma.UART5_TX.3.SyncPolarity=HAL_DMAMUX_SYNC_NO_EVENT
Dma.UART5_TX.3.SyncRequestNumber=1
Dma.UART5_TX.3.SyncSignalID=NONE
Dma.UART8_RX.4.Direction=DMA_PERIPH_TO_MEMORY
Dma.UART8_RX.4.EventEnable=DISABLE
Dma.UART8_RX.4.FIFOMode=DMA_FIFOMODE_ENABLE
Dma.UART8_RX.4.FIFOThreshold=DMA_FIFO_THRESHOLD_FULL
Dma.UART8_RX.4.Instance=DMA1_Stream4
Dma.UART8_RX.4.MemBurst=DMA_MBURST_SINGLE
Dma.UART8_RX.4.MemDataAlignment=DMA_MDATAALIGN_BYTE
Dma.UART8_RX.4.MemInc=DMA_MINC_ENABLE
Dma.UART8_RX.4.Mode=DMA_NORMAL
Dma.UART8_RX.4.PeriphBurst=DMA_PBURST_SINGLE
Dma.UART8_RX.4.PeriphDataAlignment=DMA_PDATAALIGN_BYTE
Dma.UART8_RX.4.PeriphInc=DMA_PINC_DISABLE
Dma.UART8_RX.4.Polarity=HAL_DMAMUX_REQ_GEN_RISING
Dma.UART8_RX.4.Priority=DMA_PRIORITY_LOW
Dma.UART8_RX.4.RequestNumber=1
Dma.UART8_RX.4.SignalID=NONE
Dma.UART8_RX.4.SyncEnable=DISABLE
Dma.UART8_RX.4.SyncPolarity=HAL_DMAMUX_SYNC_NO_EVENT
Dma.UART8_RX.4.SyncRequestNumber=1
Dma.UART8_RX.4.SyncSignalID=NONE
Dma.UART8_TX.5.Direction=DMA_MEMORY_TO_PERIPH
Dma.UART8_TX.5.EventEnable=DISABLE
Dma.UART8_TX.5.FIFOMode=DMA_FIFOMODE_DISABLE
Dma.UART8_TX.5.Instance=DMA1_Stream5
Dma.UART8_TX.5.MemDataAlignment=DMA_MDATAALIGN_BYTE
Dma.UART8_TX.5.MemInc=DMA_MINC_ENABLE
Dma.UART8_TX.5.Mode=DMA_NORMAL
Dma.UART8_TX.5.PeriphDataAlignment=DMA_PDATAALIGN_BYTE
Dma.UART8_TX.5.PeriphInc=DMA_PINC_DISABLE
Dma.UART8_TX.5.Polarity=HAL_DMAMUX_REQ_GEN_RISING
Dma.UART8_TX.5.Priority=DMA_PRIORITY_LOW
Dma.UART8_TX.5.RequestNumber=1
Dma.UART8_TX.5.SignalID=NONE
Dma.UART8_TX.5.SyncEnable=DISABLE
Dma.UART8_TX.5.SyncPolarity=HAL_DMAMUX_SYNC_NO_EVENT
Dma.UART8_TX.5.SyncRequestNumber=1
Dma.UART8_TX.5.SyncSignalID=NONE
Dma.USART1_RX.6.Direction=DMA_PERIPH_TO_MEMORY
Dma.USART1_RX.6.EventEnable=DISABLE
Dma.USART1_RX.6.FIFOMode=DMA_FIFOMODE_DISABLE
Dma.USART1_RX.6.Instance=DMA1_Stream6
Dma.USART1_RX.6.MemDataAlignment=DMA_MDATAALIGN_BYTE
Dma.USART1_RX.6.MemInc=DMA_MINC_ENABLE
Dma.USART1_RX.6.Mode=DMA_NORMAL
Dma.USART1_RX.6.PeriphDataAlignment=DMA_PDATAALIGN_BYTE
Dma.USART1_RX.6.PeriphInc=DMA_PINC_DISABLE
Dma.USART1_RX.6.Polarity=HAL_DMAMUX_REQ_GEN_RISING
Dma.USART1_RX.6.Priority=DMA_PRIORITY_LOW
Dma.USART1_RX.6.RequestNumber=1
Dma.USART1_RX.6.SignalID=NONE
Dma.USART1_RX.6.SyncEnable=DISABLE
Dma.USART1_RX.6.SyncPolarity=HAL_DMAMUX_SYNC_NO_EVENT
Dma.USART1_RX.6.SyncRequestNumber=1
Dma.USART1_RX.6.SyncSignalID=NONE
Dma.USART1_TX.7.Direction=DMA_MEMORY_TO_PERIPH
Dma.USART1_TX.7.EventEnable=DISABLE
Dma.USART1_TX.7.FIFOMode=DMA_FIFOMODE_DISABLE
Dma.USART1_TX.7.Instance=DMA1_Stream7
Dma.USART1_TX.7.MemDataAlignment=DMA_MDATAALIGN_BYTE
Dma.USART1_TX.7.MemInc=DMA_MINC_ENABLE
Dma.USART1_TX.7.Mode=DMA_NORMAL
Dma.USART1_TX.7.PeriphDataAlignment=DMA_PDATAALIGN_BYTE
Dma.USART1_TX.7.PeriphInc=DMA_PINC_DISABLE
Dma.USART1_TX.7.Polarity=HAL_DMAMUX_REQ_GEN_RISING
Dma.USART1_TX.7.Priority=DMA_PRIORITY_LOW
Dma.USART1_TX.7.RequestNumber=1
Dma.USART1_TX.7.SignalID=NONE
Dma.USART1_TX.7.SyncEnable=DISABLE
Dma.USART1_TX.7.SyncPolarity=HAL_DMAMUX_SYNC_NO_EVENT
Dma.USART1_TX.7.SyncRequestNumber=1
Dma.USART1_TX.7.SyncSignalID=NONE
Dma.USART3_RX.8.Direction=DMA_PERIPH_TO_MEMORY
Dma.USART3_RX.8.EventEnable=DISABLE
Dma.USART3_RX.8.FIFOMode=DMA_FIFOMODE_DISABLE
Dma.USART3_RX.8.Instance=DMA2_Stream0
Dma.USART3_RX.8.MemDataAlignment=DMA_MDATAALIGN_BYTE
Dma.USART3_RX.8.MemInc=DMA_MINC_ENABLE
Dma.USART3_RX.8.Mode=DMA_NORMAL
Dma.USART3_RX.8.PeriphDataAlignment=DMA_PDATAALIGN_BYTE
Dma.USART3_RX.8.PeriphInc=DMA_PINC_DISABLE
Dma.USART3_RX.8.Polarity=HAL_DMAMUX_REQ_GEN_RISING
Dma.USART3_RX.8.Priority=DMA_PRIORITY_LOW
Dma.USART3_RX.8.RequestNumber=1
Dma.USART3_RX.8.SignalID=NONE
Dma.USART3_RX.8.SyncEnable=DISABLE
Dma.USART3_RX.8.SyncPolarity=HAL_DMAMUX_SYNC_NO_EVENT
Dma.USART3_RX.8.SyncRequestNumber=1
Dma.USART3_RX.8.SyncSignalID=NONE
Dma.USART3_TX.9.Direction=DMA_MEMORY_TO_PERIPH
Dma.USART3_TX.9.EventEnable=DISABLE
Dma.USART3_TX.9.FIFOMode=DMA_FIFOMODE_DISABLE
Dma.USART3_TX.9.Instance=DMA2_Stream1
Dma.USART3_TX.9.MemDataAlignment=DMA_MDATAALIGN_BYTE
Dma.USART3_TX.9.MemInc=DMA_MINC_ENABLE
Dma.USART3_TX.9.Mode=DMA_NORMAL
Dma.USART3_TX.9.PeriphDataAlignment=DMA_PDATAALIGN_BYTE
Dma.USART3_TX.9.PeriphInc=DMA_PINC_DISABLE
Dma.USART3_TX.9.Polarity=HAL_DMAMUX_REQ_GEN_RISING
Dma.USART3_TX.9.Priority=DMA_PRIORITY_LOW
Dma.USART3_TX.9.RequestNumber=1
Dma.USART3_TX.9.SignalID=NONE
Dma.USART3_TX.9.SyncEnable=DISABLE
Dma.USART3_TX.9.SyncPolarity=HAL_DMAMUX_SYNC_NO_EVENT
Dma.USART3_TX.9.SyncRequestNumber=1
Dma.USART3_TX.9.SyncSignalID=NONE
Dma.USART6_RX.10.Direction=DMA_PERIPH_TO_MEMORY
Dma.USART6_RX.10.EventEnable=DISABLE
Dma.USART6_RX.10.FIFOMode=DMA_FIFOMODE_ENABLE
Dma.USART6_RX.10.FIFOThreshold=DMA_FIFO_THRESHOLD_FULL
Dma.USART6_RX.10.Instance=DMA2_Stream2
Dma.USART6_RX.10.MemBurst=DMA_MBURST_SINGLE
Dma.USART6_RX.10.MemDataAlignment=DMA_MDATAALIGN_BYTE
Dma.USART6_RX.10.MemInc=DMA_MINC_ENABLE
Dma.USART6_RX.10.Mode=DMA_NORMAL
Dma.USART6_RX.10.PeriphBurst=DMA_PBURST_SINGLE
Dma.USART6_RX.10.PeriphDataAlignment=DMA_PDATAALIGN_BYTE
Dma.USART6_RX.10.PeriphInc=DMA_PINC_DISABLE
Dma.USART6_RX.10.Polarity=HAL_DMAMUX_REQ_GEN_RISING
Dma.USART6_RX.10.Priority=DMA_PRIORITY_LOW
Dma.USART6_RX.10.RequestNumber=1
Dma.USART6_RX.10.SignalID=NONE
Dma.USART6_RX.10.SyncEnable=DISABLE
Dma.USART6_RX.10.SyncPolarity=HAL_DMAMUX_SYNC_NO_EVENT
Dma.USART6_RX.10.SyncRequestNumber=1
Dma.USART6_RX.10.SyncSignalID=NONE
Dma.USART6_TX.11.Direction=DMA_MEMORY_TO_PERIPH
Dma.USART6_TX.11.EventEnable=DISABLE
Dma.USART6_TX.11.FIFOMode=DMA_FIFOMODE_DISABLE
Dma.USART6_TX.11.Instance=DMA2_Stream3
Dma.USART6_TX.11.MemDataAlignment=DMA_MDATAALIGN_BYTE
Dma.USART6_TX.11.MemInc=DMA_MINC_ENABLE
Dma.USART6_TX.11.Mode=DMA_NORMAL
Dma.USART6_TX.11.PeriphDataAlignment=DMA_PDATAALIGN_BYTE
Dma.USART6_TX.11.PeriphInc=DMA_PINC_DISABLE
Dma.USART6_TX.11.Polarity=HAL_DMAMUX_REQ_GEN_RISING
Dma.USART6_TX.11.Priority=DMA_PRIORITY_LOW
Dma.USART6_TX.11.RequestNumber=1
Dma.USART6_TX.11.SignalID=NONE
Dma.USART6_TX.11.SyncEnable=DISABLE
Dma.USART6_TX.11.SyncPolarity=HAL_DMAMUX_SYNC_NO_EVENT
Dma.USART6_TX.11.SyncRequestNumber=1
Dma.USART6_TX.11.SyncSignalID=NONE
ETH.MediaInterface=HAL_ETH_RMII_MODE
FREERTOS_M4.Tasks01=defaultTask,24,128,StartDefaultTask,Default,NULL,Dynamic,NULL,NULL
FREERTOS_M4.configUSE_MALLOC_FAILED_HOOK=1
FREERTOS_M7.BinarySemaphores01=dynamicExampleSema,Dynamic,NULL;staticExampleSema,Static,staticExampleSemaControlBlock
FREERTOS_M7.Queues01=dynamicExampleQue,16,uint32_t,0,Dynamic,NULL,NULL;staticExampleQue,16,uint32_t,0,Static,staticExampleQueBuffer,staticExampleQueControlBlock
FREERTOS_M7.Tasks01=defaultTask,24,1024,StartDefaultTask,Default,NULL,Dynamic,NULL,NULL
FREERTOS_M7.configTOTAL_HEAP_SIZE=32768
FREERTOS_M7.configUSE_MALLOC_FAILED_HOOK=1
I2C1.Timing=0x10C0ECFF
Mcu.Family=STM32H7
Mcu.Name=STM32H757XIHx
Mcu.Package=TFBGA240
NVIC1.DMA1_Stream0_IRQn=true\:5\:0\:true\:false\:true\:false\:false\:true
NVIC1.DMA1_Stream1_IRQn=true\:5\:0\:true\:false\:true\:false\:false\:true
NVIC1.DMA1_Stream2_IRQn=true\:5\:0\:true\:false\:true\:false\:false\:true
NVIC1.DMA1_Stream3_IRQn=true\:5\:0\:true\:false\:true\:false\:false\:true
NVIC1.DMA1_Stream4_IRQn=true\:5\:0\:true\:false\:true\:false\:false\:true
NVIC1.DMA1_Stream5_IRQn=true\:5\:0\:true\:false\:true\:false\:false\:true
NVIC1.DMA1_Stream6_IRQn=true\:5\:0\:true\:false\:true\:false\:false\:true
NVIC1.DMA1_Stream7_IRQn=true\:5\:0\:true\:false\:true\:false\:false\:true
NVIC1.DMA2_Stream0_IRQn=true\:5\:0\:true\:false\:true\:false\:false\:true
NVIC1.DMA2_Stream1_IRQn=true\:5\:0\:true\:false\:true\:false\:false\:true
NVIC1.DMA2_Stream2_IRQn=true\:5\:0\:true\:false\:true\:false\:false\:true
NVIC1.DMA2_Stream3_IRQn=true\:5\:0\:true\:false\:true\:false\:false\:true
NVIC1.PriorityGroup=NVIC_PRIORITYGROUP_4
NVIC1.TimeBase=TIM1_UP_IRQn
NVIC1.TimeBaseIP=TIM1
NVIC1.UART4_IRQn=true\:5\:0\:true\:false\:true\:false\:true\:true
NVIC1.UART5_IRQn=true\:5\:0\:true\:false\:true\:false\:true\:true
NVIC1.UART8_IRQn=true\:5\:0\:true\:false\:true\:false\:true\:true
NVIC1.USART1_IRQn=true\:5\:0\:true\:false\:true\:false\:true\:true
NVIC1.USART3_IRQn=true\:5\:0\:true\:false\:true\:false\:true\:true
NVIC1.USART6_IRQn=true\:5\:0\:true\:false\:true\:false\:true\:true
NVIC2.PriorityGroup=NVIC_PRIORITYGROUP_4
NVIC2.TimeBase=TIM1_UP_IRQn
NVIC2.TimeBaseIP=TIM1
PA0.Mode=Asynchronous
PA0.PinAttribute=CortexM7
PA0.Signal=UART4_TX
PA1.GPIO_Label=RMII_REF_CLK [LAN8742A_REFCLK0]
PA1.Mode=RMII
PA1.PinAttribute=CortexM7
PA1.Signal=ETH_REF_CLK
PA10.GPIO_Label=eINK_RST
PA10.PinAttribute=CortexM7
PA10.Signal=GPIO_Output
PA11.GPIO_Label=USB_FS1_DM
PA11.Mode=Device_Only
PA11.PinAttribute=CortexM7
PA11.Signal=USB_OTG_FS_DM
PA12.GPIO_Label=USB_FS1_DP
PA12.Mode=Device_Only
PA12.PinAttribute=CortexM7
PA12.Signal=USB_OTG_FS_DP
PA15\ (JTDI).Mode=DSIHost_Adapted_TE
PA15\ (JTDI).PinAttribute=CortexM7
PA15\ (JTDI).Signal=DSIHOST_TE
PA2.GPIO_Label=RMII_MDIO [LAN8742A_MDIO]
PA2.Mode=RMII
PA2.PinAttribute=CortexM7
PA2.Signal=ETH_MDIO
PA3.GPIO_Label=ULPI_D0 [USB3320C_D0]
PA3.Mode=Device_HS
PA3.PinAttribute=CortexM7
PA3.Signal=USB_OTG_HS_ULPI_D0
PA5.GPIO_Label=ULPI_CK  [USB3320C_CLKOUT]
PA5.Mode=Device_HS
PA5.PinAttribute=CortexM7
PA5.Signal=USB_OTG_HS_ULPI_CK
PA7.GPIO_Label=RMII_CRS_DV [LAN8742A_CRS_DV]
PA7.Mode=RMII
PA7.PinAttribute=CortexM7
PA7.Signal=ETH_CRS_DV
PA8.GPIO_Label=MCO1
PA8.Mode=Clock-out-1
PA8.PinAttribute=CortexM7
PA8.Signal=RCC_MCO_1
PA9.GPIO_Label=USB_FS1_VBUS
PA9.Mode=Activate_VBUS
PA9.PinAttribute=CortexM7
PA9.Signal=USB_OTG_FS_VBUS
PB0.GPIO_Label=ULPI_D1 [USB3320C_D1]
PB0.Mode=Device_HS
PB0.PinAttribute=CortexM7
PB0.Signal=USB_OTG_HS_ULPI_D1
PB1.GPIO_Label=ULPI_D2 [USB3320C_D2]
PB1.Mode=Device_HS
PB1.PinAttribute=CortexM7
PB1.Signal=USB_OTG_HS_ULPI_D2
PB10.GPIO_Label=ULPI_D3 [USB3320C_D3]
PB10.Mode=Device_HS
PB10.PinAttribute=CortexM7
PB10.Signal=USB_OTG_HS_ULPI_D3
PB11.GPIO_Label=ULPI_D4 [USB3320C_D4]
PB11.Mode=Device_HS
PB11.PinAttribute=CortexM7
PB11.Signal=USB_OTG_HS_ULPI_D4
PB12.GPIO_Label=ULPI_D5 [USB3320C_D5]
PB12.Mode=Device_HS
PB12.PinAttribute=CortexM7
PB12.Signal=USB_OTG_HS_ULPI_D5
PB13.GPIO_Label=ULPI_D6 [USB3320C_D6]
PB13.Mode=Device_HS
PB13.PinAttribute=CortexM7
PB13.Signal=USB_OTG_HS_ULPI_D6
PB14.GPIO_Label=RS232_TX [ST3241EBPR_T2IN]
PB14.Mode=Asynchronous
PB14.PinAttribute=CortexM7
PB14.Signal=USART1_TX
PB15.GPIO_Label=RS_232RX [ST3241EBPR_R3OUT]
PB15.Mode=Asynchronous
PB15.PinAttribute=CortexM7
PB15.Signal=USART1_RX
PB5.GPIO_Label=ULPI_D7 [USB3320C_D7]
PB5.Mode=Device_HS
PB5.PinAttribute=CortexM7
PB5.Signal=USB_OTG_HS_ULPI_D7
PB6.GPIO_Label=I2C1_SCL [STM32L152CCT6_I2C_SCL]
PB6.Mode=I2C
PB6.PinAttribute=CortexM7
PB6.Signal=I2C1_SCL
PB7.GPIO_Label=I2C1_SDA [STM32L152CCT6_I2C_SDA]
PB7.Mode=I2C
PB7.PinAttribute=CortexM7
PB7.Signal=I2C1_SDA
PB8.Mode=Asynchronous
PB8.PinAttribute=CortexM7
PB8.Signal=UART4_RX
PB9.GPIO_Label=SDIO1_CDIR
PB9.Mode=SD_4_bits_Wide_bus_dir_voltage_converter
PB9.PinAttribute=CortexM4
PB9.Signal=SDMMC1_CDIR
PC0.GPIO_Label=ULPI_STP [USB3320C_STP]
PC0.Mode=Device_HS
PC0.PinAttribute=CortexM7
PC0.Signal=USB_OTG_HS_ULPI_STP
PC1.GPIO_Label=RMII_MDC [LAN8742A_MDC]
PC1.Mode=RMII
PC1.PinAttribute=CortexM7
PC1.Signal=ETH_MDC
PC10.Mode=Asynchronous
PC10.PinAttribute=CortexM7
PC10.Signal=USART3_TX
PC11.Mode=Asynchronous
PC11.PinAttribute=CortexM7
PC11.Signal=USART3_RX
PC12.Mode=Asynchronous
PC12.PinAttribute=CortexM7
PC12.Signal=UART5_TX
PC13.GPIO_Label=B3 [Tamper Key Button]
PC13.PinAttribute=CortexM7
PC13.Signal=GPIO_Input
PC14-OSC32_IN\ (OSC32_IN).GPIO_Label=OSC32_IN
PC14-OSC32_IN\ (OSC32_IN).Mode=LSE-External-Oscillator
PC14-OSC32_IN\ (OSC32_IN).PinAttribute=CortexM7
PC14-OSC32_IN\ (OSC32_IN).Signal=RCC_OSC32_IN
PC15-OSC32_OUT\ (OSC32_OUT).GPIO_Label=OSC32_OUT
PC15-OSC32_OUT\ (OSC32_OUT).Mode=LSE-External-Oscillator
PC15-OSC32_OUT\ (OSC32_OUT).PinAttribute=CortexM7
PC15-OSC32_OUT\ (OSC32_OUT).Signal=RCC_OSC32_OUT
PC4.GPIO_Label=RMII_RXD0 [LAN8742A_RXD0]
PC4.Mode=RMII
PC4.PinAttribute=CortexM7
PC4.Signal=ETH_RXD0
PC5.GPIO_Label=RMII_RXD1 [LAN8742A_RXD1]
PC5.Mode=RMII
PC5.PinAttribute=CortexM7
PC5.Signal=ETH_RXD1
PC6.GPIO_Label=SDIO1_D0DIR
PC6.Mode=SD_4_bits_Wide_bus_dir_voltage_converter
PC6.PinAttribute=CortexM4
PC6.Signal=SDMMC1_D0DIR
PC7.GPIO_Label=SDIO1_D123DIR
PC7.Mode=SD_4_bits_Wide_bus_dir_voltage_converter
PC7.PinAttribute=CortexM4
PC7.Signal=SDMMC1_D123DIR
PD0.GPIO_Label=D2 [IS42S32800G_DQ2]
PD0.PinAttribute=CortexM7
PD0.Signal=FMC_D2_DA2
PD1.GPIO_Label=D3 [IS42S32800G_DQ3]
PD1.PinAttribute=CortexM7
PD1.Signal=FMC_D3_DA3
PD10.GPIO_Label=D15 [IS42S32800G_DQ15]
PD10.PinAttribute=CortexM7
PD10.Signal=FMC_D15_DA15
PD11.GPIO_Label=A16 [PC28F128M29EWLA_A16]
PD11.PinAttribute=CortexM7
PD11.Signal=FMC_A16_CLE
PD12.GPIO_Label=A17 [PC28F128M29EWLA_A17]
PD12.PinAttribute=CortexM7
PD12.Signal=FMC_A17_ALE
PD13.GPIO_Label=A18 [PC28F128M29EWLA_A18]
PD13.PinAttribute=CortexM7
PD13.Signal=FMC_A18
PD14.GPIO_Label=D0 [IS42S32800G_DQ0]
PD14.PinAttribute=CortexM7
PD14.Signal=FMC_D0_DA0
PD15.GPIO_Label=D1 [IS42S32800G_DQ1]
PD15.PinAttribute=CortexM7
PD15.Signal=FMC_D1_DA1
PD2.Mode=Asynchronous
PD2.PinAttribute=CortexM7
PD2.Signal=UART5_RX
PD4.GPIO_Label=FMC_NOE [IS61WV102416BLL_OE]
PD4.PinAttribute=CortexM7
PD4.Signal=FMC_NOE
PD5.GPIO_Label=FMC_NWE [IS61WV102416BLL_WE]
PD5.PinAttribute=CortexM7
PD5.Signal=FMC_NWE
PD6.GPIO_Label=FMC_NWAIT [PC28F128M29EWLA_RB]
PD6.PinAttribute=CortexM7
PD6.Signal=FMC_NWAIT
PD7.GPIO_Label=FMC_NE1 [PC28F128M29EWLA_E]
PD7.Mode=NorPsramChipSelect1_1
PD7.PinAttribute=CortexM7
PD7.Signal=FMC_NE1
PD8.GPIO_Label=D13 [IS42S32800G_DQ13]
PD8.PinAttribute=CortexM7
PD8.Signal=FMC_D13_DA13
PD9.GPIO_Label=D14 [IS42S32800G_DQ14]
PD9.PinAttribute=CortexM7
PD9.Signal=FMC_D14_DA14
PE0.GPIO_Label=FMC_NBL0 [IS42S32800G_DQM0]
PE0.PinAttribute=CortexM7
PE0.Signal=FMC_NBL0
PE1.GPIO_Label=FMC_NBL1 [IS42S32800G_DQM1]
PE1.PinAttribute=CortexM7
PE1.Signal=FMC_NBL1
PE10.GPIO_Label=D7 [IS42S32800G_DQ7]
PE10.PinAttribute=CortexM7
PE10.Signal=FMC_D7_DA7
PE11.GPIO_Label=D8 [IS42S32800G_DQ8]
PE11.PinAttribute=CortexM7
PE11.Signal=FMC_D8_DA8
PE12.GPIO_Label=D9 [IS42S32800G_DQ9]
PE12.PinAttribute=CortexM7
PE12.Signal=FMC_D9_DA9
PE13.GPIO_Label=D10 [IS42S32800G_DQ10]
PE13.PinAttribute=CortexM7
PE13.Signal=FMC_D10_DA10
PE14.GPIO_Label=D11 [IS42S32800G_DQ11]
PE14.PinAttribute=CortexM7
PE14.Signal=FMC_D11_DA11
PE15.GPIO_Label=D12 [IS42S32800G_DQ12]
PE15.PinAttribute=CortexM7
PE15.Signal=FMC_D12_DA12
PE7.GPIO_Label=D4 [IS42S32800G_DQ4]
PE7.PinAttribute=CortexM7
PE7.Signal=FMC_D4_DA4
PE8.GPIO_Label=D5 [IS42S32800G_DQ5]
PE8.PinAttribute=CortexM7
PE8.Signal=FMC_D5_DA5
PE9.GPIO_Label=D6 [IS42S32800G_DQ6]
PE9.PinAttribute=CortexM7
PE9.Signal=FMC_D6_DA6
PF0.GPIO_Label=A0 [PC28F128M29EWLA_A0]
PF0.PinAttribute=CortexM7
PF0.Signal=FMC_A0
PF1.GPIO_Label=A1 [PC28F128M29EWLA_A1]
PF1.PinAttribute=CortexM7
PF1.Signal=FMC_A1
PF11.GPIO_Label=SNDRAS [IS42S32800G_RAS]
PF11.PinAttribute=CortexM7
PF11.Signal=FMC_SDNRAS
PF12.GPIO_Label=A6 [PC28F128M29EWLA_A6]
PF12.PinAttribute=CortexM7
PF12.Signal=FMC_A6
PF13.GPIO_Label=A7 [PC28F128M29EWLA_A7]
PF13.PinAttribute=CortexM7
PF13.Signal=FMC_A7
PF14.GPIO_Label=A8 [PC28F128M29EWLA_A8]
PF14.PinAttribute=CortexM7
PF14.Signal=FMC_A8
PF15.GPIO_Label=A9 [PC28F128M29EWLA_A9]
PF15.PinAttribute=CortexM7
PF15.Signal=FMC_A9
PF2.GPIO_Label=A2 [PC28F128M29EWLA_A2]
PF2.PinAttribute=CortexM7
PF2.Signal=FMC_A2
PF3.GPIO_Label=A3 [PC28F128M29EWLA_A3]
PF3.PinAttribute=CortexM7
PF3.Signal=FMC_A3
PF4.GPIO_Label=A4 [PC28F128M29EWLA_A4]
PF4.PinAttribute=CortexM7
PF4.Signal=FMC_A4
PF5.GPIO_Label=A5 [PC28F128M29EWLA_A5]
PF5.PinAttribute=CortexM7
PF5.Signal=FMC_A5
PF8.Mode=Full_Duplex_Master
PF8.PinAttribute=CortexM7
PF8.Signal=SPI5_MISO
PF9.Mode=Full_Duplex_Master
PF9.PinAttribute=CortexM7
PF9.Signal=SPI5_MOSI
PG0.GPIO_Label=A10 [PC28F128M29EWLA_A10]
PG0.PinAttribute=CortexM7
PG0.Signal=FMC_A10
PG1.GPIO_Label=A11 [PC28F128M29EWLA_A11]
PG1.PinAttribute=CortexM7
PG1.Signal=FMC_A11
PG10.GPIO_Label=FMC_NE3 [IS61WV102416BLL_CE]
PG10.Mode=NorPsramChipSelect3_2
PG10.PinAttribute=CortexM7
PG10.Signal=FMC_NE3
PG11.GPIO_Label=RMII_TX_EN [LAN8742A_TXEN]
PG11.Mode=RMII
PG11.PinAttribute=CortexM7
PG11.Signal=ETH_TX_EN
PG12.GPIO_Label=RMII_TXD1 [LAN8742A_TXD1]
PG12.Mode=RMII
PG12.PinAttribute=CortexM7
PG12.Signal=ETH_TXD1
PG13.GPIO_Label=RMII_TXD0 [LAN8742A_TXD0]
PG13.Mode=RMII
PG13.PinAttribute=CortexM7
PG13.Signal=ETH_TXD0
PG14.Mode=Asynchronous
PG14.PinAttribute=CortexM7
PG14.Signal=USART6_TX
PG15.GPIO_Label=SDNCAS [IS42S32800G_CAS]
PG15.PinAttribute=CortexM7
PG15.Signal=FMC_SDNCAS
PG2.GPIO_Label=A12 [PC28F128M29EWLA_A12]
PG2.PinAttribute=CortexM7
PG2.Signal=FMC_A12
PG3.GPIO_Label=A13 [PC28F128M29EWLA_A13]
PG3.PinAttribute=CortexM7
PG3.Signal=FMC_A13
PG4.PinAttribute=CortexM7
PG4.Signal=FMC_A14_BA0
PG5.PinAttribute=CortexM7
PG5.Signal=FMC_A15_BA1
PG7.GPIO_Label=eINK_BUSY
PG7.PinAttribute=CortexM7
PG7.Signal=GPIO_Output
PG8.GPIO_Label=SDCLK [IS42S32800G_CLK]
PG8.PinAttribute=CortexM7
PG8.Signal=FMC_SDCLK
PG9.Mode=Asynchronous
PG9.PinAttribute=CortexM7
PG9.Signal=USART6_RX
PH0-OSC_IN\ (PH0).GPIO_Label=OSC_IN
PH0-OSC_IN\ (PH0).Mode=HSE-External-Oscillator
PH0-OSC_IN\ (PH0).PinAttribute=CortexM7
PH0-OSC_IN\ (PH0).Signal=RCC_OSC_IN
PH1-OSC_OUT\ (PH1).GPIO_Label=OSC_OUT
PH1-OSC_OUT\ (PH1).Mode=HSE-External-Oscillator
PH1-OSC_OUT\ (PH1).PinAttribute=CortexM7
PH1-OSC_OUT\ (PH1).Signal=RCC_OSC_OUT
PH10.GPIO_Label=D18 [IS42S32800G_DQ18]
PH10.PinAttribute=CortexM7
PH10.Signal=FMC_D18
PH11.GPIO_Label=D19 [IS42S32800G_DQ19]
PH11.PinAttribute=CortexM7
PH11.Signal=FMC_D19
PH12.GPIO_Label=D20 [IS42S32800G_DQ20]
PH12.PinAttribute=CortexM7
PH12.Signal=FMC_D20
PH13.GPIO_Label=D21 [IS42S32800G_DQ21]
PH13.PinAttribute=CortexM7
PH13.Signal=FMC_D21
PH14.GPIO_Label=D22 [IS42S32800G_DQ22]
PH14.PinAttribute=CortexM7
PH14.Signal=FMC_D22
PH15.GPIO_Label=D23 [IS42S32800G_DQ23]
PH15.PinAttribute=CortexM7
PH15.Signal=FMC_D23
PH4.GPIO_Label=ULPI_NXT [USB3320C_NXT]
PH4.Mode=Device_HS
PH4.PinAttribute=CortexM7
PH4.Signal=USB_OTG_HS_ULPI_NXT
PH5.GPIO_Label=SDNWE [IS42S32800G_WE]
PH5.PinAttribute=CortexM7
PH5.Signal=FMC_SDNWE
PH6.GPIO_Label=SDNE1 [IS42S32800G_CS]
PH6.Mode=SdramChipSelect2_1
PH6.PinAttribute=CortexM7
PH6.Signal=FMC_SDNE1
PH7.GPIO_Label=SDCKE1 [IS42S32800G_CKE]
PH7.Mode=SdramChipSelect2_1
PH7.PinAttribute=CortexM7
PH7.Signal=FMC_SDCKE1
PH8.GPIO_Label=D16 [IS42S32800G_DQ16]
PH8.PinAttribute=CortexM7
PH8.Signal=FMC_D16
PH9.GPIO_Label=D17 [IS42S32800G_DQ17]
PH9.PinAttribute=CortexM7
PH9.Signal=FMC_D17
PI0.GPIO_Label=D24 [IS42S32800G_DQ24]
PI0.PinAttribute=CortexM7
PI0.Signal=FMC_D24
PI1.GPIO_Label=D25 [IS42S32800G_DQ25]
PI1.PinAttribute=CortexM7
PI1.Signal=FMC_D25
PI10.GPIO_Label=D31 [IS42S32800G_DQ31]
PI10.PinAttribute=CortexM7
PI10.Signal=FMC_D31
PI11.GPIO_Label=ULPI_DIR [USB3320C_DIR]
PI11.Mode=Device_HS
PI11.PinAttribute=CortexM7
PI11.Signal=USB_OTG_HS_ULPI_DIR
PI2.GPIO_Label=D26 [IS42S32800G_DQ26]
PI2.PinAttribute=CortexM7
PI2.Signal=FMC_D26
PI3.GPIO_Label=D27 [IS42S32800G_DQ27
PI3.PinAttribute=CortexM7
PI3.Signal=FMC_D27
PI4.GPIO_Label=FMC_NBL2 [IS42S32800G_DQM2]
PI4.PinAttribute=CortexM7
PI4.Signal=FMC_NBL2
PI5.GPIO_Label=FMC_NBL3 [IS42S32800G_DQM3]
PI5.PinAttribute=CortexM7
PI5.Signal=FMC_NBL3
PI6.GPIO_Label=D28 [IS42S32800G_DQ28]
PI6.PinAttribute=CortexM7
PI6.Signal=FMC_D28
PI7.GPIO_Label=D29 [IS42S32800G_DQ29]
PI7.PinAttribute=CortexM7
PI7.Signal=FMC_D29
PI8.GPIO_Label=GPIO_EXPANDER_INT [MFX_V3_IRQOUT]
PI8.PinAttribute=Free
PI8.Signal=GPXTI8
PI9.GPIO_Label=D30 [IS42S32800G_DQ30]
PI9.PinAttribute=CortexM7
PI9.Signal=FMC_D30
PJ8.Mode=Asynchronous
PJ8.PinAttribute=CortexM7
PJ8.Signal=UART8_TX
PJ9.Mode=Asynchronous
PJ9.PinAttribute=CortexM7
PJ9.Signal=UART8_RX
PK0.Mode=Full_Duplex_Master
PK0.PinAttribute=CortexM7
PK0.Signal=SPI5_SCK
PK1.Mode=NSS_Signal_Hard_Output
PK1.PinAttribute=CortexM7
PK1.Signal=SPI5_NSS
PK2.GPIO_Label=eINC_DAT_CMD
PK2.PinAttribute=CortexM7
PK2.Signal=GPIO_Output
PK3.GPIO_Label=LD1
PK3.PinAttribute=CortexM7
PK3.Signal=GPIO_Output
PK4.GPIO_Label=LD2
PK4.PinAttribute=CortexM7
PK4.Signal=GPIO_Output
PK5.GPIO_Label=LD3
PK5.PinAttribute=CortexM7
PK5.Signal=GPIO_Output
PK6.GPIO_Label=LD4
PK6.PinAttribute=CortexM7
PK6.Signal=GPIO_Output
ProjectManager.HeapSize=0x200
ProjectManager.StackSize=0x400
ProjectManager.TargetToolchain=STM32CubeIDE
RCC.ADCFreq_Value=58593750
RCC.APB1Freq_Value=100000000
RCC.APB2Freq_Value=100000000
RCC.APB3Freq_Value=100000000
RCC.APB4Freq_Value=100000000
RCC.CortexFreq_Value=400000000
RCC.D1PPRE=RCC_APB3_DIV2
RCC.D2PPRE1=RCC_APB1_DIV2
RCC.D2PPRE2=RCC_APB2_DIV2
RCC.D3PPRE=RCC_APB4_DIV2
RCC.DIVM1=2
RCC.DIVM2=4
RCC.DIVN1=64
RCC.DIVN2=9
RCC.DIVP2=1
RCC.DSITX_Div=2
RCC.HCLKFreq_Value=200000000
RCC.HPRE=RCC_HCLK_DIV2
RCC.PLL2FRACN=3072
RCC.PLL3FRACN=0
RCC.PLLDSINDIV=10
RCC.PLLFRACN=0
RCC.PLLSourceVirtual=RCC_PLLSOURCE_HSE
RCC.RCC_MCODiv1=RCC_MCODIV_10
RCC.SYSCLKFreq_VALUE=400000000
RCC.SYSCLKSource=RCC_SYSCLKSOURCE_PLLCLK
RCC.SupplySource=PWR_DIRECT_SMPS_SUPPLY
RCC.USBCLockSelection=RCC_USBCLKSOURCE_HSI48
RCC.USBFreq_Value=48000000
SH.FMC_A0.0=FMC_A0,19b-a1
SH.FMC_A0.1=FMC_A0,19b-a2
SH.FMC_A0.2=FMC_A0,11b-sda1
SH.FMC_A1.0=FMC_A1,19b-a1
SH.FMC_A1.1=FMC_A1,19b-a2
SH.FMC_A1.2=FMC_A1,11b-sda1
SH.FMC_A10.0=FMC_A10,19b-a1
SH.FMC_A10.1=FMC_A10,19b-a2
SH.FMC_A10.2=FMC_A10,11b-sda1
SH.FMC_A11.0=FMC_A11,19b-a1
SH.FMC_A11.1=FMC_A11,19b-a2
SH.FMC_A12.0=FMC_A12,19b-a1
SH.FMC_A12.1=FMC_A12,19b-a2
SH.FMC_A13.0=FMC_A13,19b-a1
SH.FMC_A13.1=FMC_A13,19b-a2
SH.FMC_A14_BA0.0=FMC_A14,19b-a1
SH.FMC_A14_BA0.1=FMC_A14,19b-a2
SH.FMC_A14_BA0.2=FMC_BA0,FourSdramBanks1
SH.FMC_A15_BA1.0=FMC_A15,19b-a1
SH.FMC_A15_BA1.1=FMC_A15,19b-a2
SH.FMC_A15_BA1.2=FMC_BA1,FourSdramBanks1
SH.FMC_A16_CLE.0=FMC_A16,19b-a1
SH.FMC_A16_CLE.1=FMC_A16,19b-a2
SH.FMC_A17_ALE.0=FMC_A17,19b-a1
SH.FMC_A17_ALE.1=FMC_A17,19b-a2
SH.FMC_A18.0=FMC_A18,19b-a1
SH.FMC_A18.1=FMC_A18,19b-a2
SH.FMC_A2.0=FMC_A2,19b-a1
SH.FMC_A2.1=FMC_A2,19b-a2
SH.FMC_A2.2=FMC_A2,11b-sda1
SH.FMC_A3.0=FMC_A3,19b-a1
SH.FMC_A3.1=FMC_A3,19b-a2
SH.FMC_A3.2=FMC_A3,11b-sda1
SH.FMC_A4.0=FMC_A4,19b-a1
SH.FMC_A4.1=FMC_A4,19b-a2
SH.FMC_A4.2=FMC_A4,11b-sda1
SH.FMC_A5.0=FMC_A5,19b-a1
SH.FMC_A5.1=FMC_A5,19b-a2
SH.FMC_A5.2=FMC_A5,11b-sda1
SH.FMC_A6.0=FMC_A6,19b-a1
SH.FMC_A6.1=FMC_A6,19b-a2
SH.FMC_A6.2=FMC_A6,11b-sda1
SH.FMC_A7.0=FMC_A7,19b-a1
SH.FMC_A7.1=FMC_A7,19b-a2
SH.FMC_A7.2=FMC_A7,11b-sda1
SH.FMC_A8.0=FMC_A8,19b-a1
SH.FMC_A8.1=FMC_A8,19b-a2
SH.FMC_A8.2=FMC_A8,11b-sda1
SH.FMC_A9.0=FMC_A9,19b-a1
SH.FMC_A9.1=FMC_A9,19b-a2
SH.FMC_A9.2=FMC_A9,11b-sda1
SH.FMC_D0_DA0.0=FMC_D0,16b-d1
SH.FMC_D0_DA0.1=FMC_D0,16b-d2
SH.FMC_D0_DA0.2=FMC_D0,sd-32b-d1
SH.FMC_D10_DA10.0=FMC_D10,16b-d1
SH.FMC_D10_DA10.1=FMC_D10,16b-d2
SH.FMC_D10_DA10.2=FMC_D10,sd-32b-d1
SH.FMC_D11_DA11.0=FMC_D11,16b-d1
SH.FMC_D11_DA11.1=FMC_D11,16b-d2
SH.FMC_D11_DA11.2=FMC_D11,sd-32b-d1
SH.FMC_D12_DA12.0=FMC_D12,16b-d1
SH.FMC_D12_DA12.1=FMC_D12,16b-d2
SH.FMC_D12_DA12.2=FMC_D12,sd-32b-d1
SH.FMC_D13_DA13.0=FMC_D13,16b-d1
SH.FMC_D13_DA13.1=FMC_D13,16b-d2
SH.FMC_D13_DA13.2=FMC_D13,sd-32b-d1
SH.FMC_D14_DA14.0=FMC_D14,16b-d1
SH.FMC_D14_DA14.1=FMC_D14,16b-d2
SH.FMC_D14_DA14.2=FMC_D14,sd-32b-d1
SH.FMC_D15_DA15.0=FMC_D15,16b-d1
SH.FMC_D15_DA15.1=FMC_D15,16b-d2
SH.FMC_D15_DA15.2=FMC_D15,sd-32b-d1
SH.FMC_D16.0=FMC_D16,sd-32b-d1
SH.FMC_D17.0=FMC_D17,sd-32b-d1
SH.FMC_D18.0=FMC_D18,sd-32b-d1
SH.FMC_D19.0=FMC_D19,sd-32b-d1
SH.FMC_D1_DA1.0=FMC_D1,16b-d1
SH.FMC_D1_DA1.1=FMC_D1,16b-d2
SH.FMC_D1_DA1.2=FMC_D1,sd-32b-d1
SH.FMC_D20.0=FMC_D20,sd-32b-d1
SH.FMC_D21.0=FMC_D21,sd-32b-d1
SH.FMC_D22.0=FMC_D22,sd-32b-d1
SH.FMC_D23.0=FMC_D23,sd-32b-d1
SH.FMC_D24.0=FMC_D24,sd-32b-d1
SH.FMC_D25.0=FMC_D25,sd-32b-d1
SH.FMC_D26.0=FMC_D26,sd-32b-d1
SH.FMC_D27.0=FMC_D27,sd-32b-d1
SH.FMC_D28.0=FMC_D28,sd-32b-d1
SH.FMC_D29.0=FMC_D29,sd-32b-d1
SH.FMC_D2_DA2.0=FMC_D2,16b-d1
SH.FMC_D2_DA2.1=FMC_D2,16b-d2
SH.FMC_D2_DA2.2=FMC_D2,sd-32b-d1
SH.FMC_D30.0=FMC_D30,sd-32b-d1
SH.FMC_D31.0=FMC_D31,sd-32b-d1
SH.FMC_D3_DA3.0=FMC_D3,16b-d1
SH.FMC_D3_DA3.1=FMC_D3,16b-d2
SH.FMC_D3_DA3.2=FMC_D3,sd-32b-d1
SH.FMC_D4_DA4.0=FMC_D4,16b-d1
SH.FMC_D4_DA4.1=FMC_D4,16b-d2
SH.FMC_D4_DA4.2=FMC_D4,sd-32b-d1
SH.FMC_D5_DA5.0=FMC_D5,16b-d1
SH.FMC_D5_DA5.1=FMC_D5,16b-d2
SH.FMC_D5_DA5.2=FMC_D5,sd-32b-d1
SH.FMC_D6_DA6.0=FMC_D6,16b-d1
SH.FMC_D6_DA6.1=FMC_D6,16b-d2
SH.FMC_D6_DA6.2=FMC_D6,sd-32b-d1
SH.FMC_D7_DA7.0=FMC_D7,16b-d1
SH.FMC_D7_DA7.1=FMC_D7,16b-d2
SH.FMC_D7_DA7.2=FMC_D7,sd-32b-d1
SH.FMC_D8_DA8.0=FMC_D8,16b-d1
SH.FMC_D8_DA8.1=FMC_D8,16b-d2
SH.FMC_D8_DA8.2=FMC_D8,sd-32b-d1
SH.FMC_D9_DA9.0=FMC_D9,16b-d1
SH.FMC_D9_DA9.1=FMC_D9,16b-d2
SH.FMC_D9_DA9.2=FMC_D9,sd-32b-d1
SH.FMC_NBL0.0=FMC_NBL0,2ByteEnable2
SH.FMC_NBL0.1=FMC_NBL0,Sd4ByteEnable1
SH.FMC_NBL1.0=FMC_NBL1,2ByteEnable2
SH.FMC_NBL1.1=FMC_NBL1,Sd4ByteEnable1
SH.FMC_NBL2.0=FMC_NBL2,Sd4ByteEnable1
SH.FMC_NBL3.0=FMC_NBL3,Sd4ByteEnable1
SH.FMC_NOE.0=FMC_NOE,NorFlash1
SH.FMC_NOE.1=FMC_NOE,Sram2
SH.FMC_NWAIT.0=FMC_NWAIT,AsynchronousWait1
SH.FMC_NWAIT.1=FMC_NWAIT,AsynchronousWait2
SH.FMC_NWE.0=FMC_NWE,NorFlash1
SH.FMC_NWE.1=FMC_NWE,Sram2
SH.FMC_SDCLK.0=FMC_SDCLK,11b-sda1
SH.FMC_SDNCAS.0=FMC_SDNCAS,11b-sda1
SH.FMC_SDNRAS.0=FMC_SDNRAS,11b-sda1
SH.FMC_SDNWE.0=FMC_SDNWE,11b-sda1
SPI5.CalculateBaudRate=50.0 MBits/s
SPI5.Direction=SPI_DIRECTION_2LINES
SPI5.Mode=SPI_MODE_MASTER
SPI5.VirtualNSS=VM_NSSHARD
SPI5.VirtualType=VM_MASTER
USART1.VirtualMode-Asynchronous=VM_ASYNC
USART3.VirtualMode-Asynchronous=VM_ASYNC
USART6.VirtualMode-Asynchronous=VM_ASYNC
USB_OTG_FS.VirtualMode=Device_Only
USB_OTG_HS.VirtualMode-Device_HS=Device_HS
VP_FREERTOS_M4_VS_CMSIS_V2.Mode=CMSIS_V2
VP_FREERTOS_M7_VS_CMSIS_V2.Mode=CMSIS_V2
VP_LTDC_DSIMode.Mode=RGB888
VP_SYS_M4_VS_tim1.Mode=TIM1
VP_SYS_VS_tim1.Mode=TIM1
board=STM32H757I-EVAL

// file: CM7/Core/Src/main.c
/* USER CODE BEGIN Header */
/**
  ******************************************************************************
  * @file           : main.c
  * @brief          : Main program body
  ******************************************************************************
  * @attention
  *
  * <h2><center>&copy; Copyright (c) 2020 STMicroelectronics.
  * All rights reserved.</center></h2>
  *
  * This software component is licensed by ST under Ultimate Liberty license
  * SLA0044, the "License"; You may not use this file except in compliance with
  * the License. You may obtain a copy of the License at:
  *                             www.st.com/SLA0044
  *
  ******************************************************************************
  */
/* USER CODE END Header */

#include "main.h"
#include "string.h"
#include "cmsis_os.h"

/* USER CODE BEGIN Includes */
#include "greenThreads.h"
/* USER CODE END Includes */

typedef StaticQueue_t osStaticMessageQDef_t;
typedef StaticSemaphore_t osStaticSemaphoreDef_t;

/* USER CODE BEGIN PD */

#define HSEM_ID_0 (0U) /* HW semaphore 0*/
/* USER CODE END PD */

#if defined ( __ICCARM__ ) /*!< IAR Compiler */

#pragma location=0x30040000
ETH_DMADescTypeDef  DMARxDscrTab[ETH_RX_DESC_CNT]; /* Ethernet Rx DMA Descriptors */
#pragma location=0x30040060
ETH_DMADescTypeDef  DMATxDscrTab[ETH_TX_DESC_CNT]; /* Ethernet Tx DMA Descriptors */
#pragma location=0x30040200
uint8_t Rx_Buff[ETH_RX_DESC_CNT][ETH_MAX_PACKET_SIZE]; /* Ethernet Receive Buffers */

#elif defined ( __CC_ARM )  /* MDK ARM Compiler */

__attribute__((at(0x30040000))) ETH_DMADescTypeDef  DMARxDscrTab[ETH_RX_DESC_CNT]; /* Ethernet Rx DMA Descriptors */
__attribute__((at(0x30040060))) ETH_DMADescTypeDef  DMATxDscrTab[ETH_TX_DESC_CNT]; /* Ethernet Tx DMA Descriptors */
__attribute__((at(0x30040200))) uint8_t Rx_Buff[ETH_RX_DESC_CNT][ETH_MAX_PACKET_SIZE]; /* Ethernet Receive Buffer */

#elif defined ( __GNUC__ ) /* GNU Compiler */

ETH_DMADescTypeDef DMARxDscrTab[ETH_RX_DESC_CNT] __attribute__((section(".RxDecripSection"))); /* Ethernet Rx DMA Descriptors */
ETH_DMADescTypeDef DMATxDscrTab[ETH_TX_DESC_CNT] __attribute__((section(".TxDecripSection")));   /* Ethernet Tx DMA Descriptors */
uint8_t Rx_Buff[ETH_RX_DESC_CNT][ETH_MAX_PACKET_SIZE] __attribute__((section(".RxArraySection"))); /* Ethernet Receive Buffers */

#endif

ETH_TxPacketConfig TxConfig;

DSI_HandleTypeDef hdsi;

ETH_HandleTypeDef heth;

I2C_HandleTypeDef hi2c1;

LTDC_HandleTypeDef hltdc;

SPI_HandleTypeDef hspi5;

UART_HandleTypeDef huart4;
UART_HandleTypeDef huart5;
UART_HandleTypeDef huart8;
UART_HandleTypeDef huart1;
UART_HandleTypeDef huart3;
UART_HandleTypeDef huart6;
DMA_HandleTypeDef hdma_uart4_rx;
DMA_HandleTypeDef hdma_uart4_tx;
DMA_HandleTypeDef hdma_uart5_rx;
DMA_HandleTypeDef hdma_uart5_tx;
DMA_HandleTypeDef hdma_uart8_rx;
DMA_HandleTypeDef hdma_uart8_tx;
DMA_HandleTypeDef hdma_usart1_rx;
DMA_HandleTypeDef hdma_usart1_tx;
DMA_HandleTypeDef hdma_usart3_rx;
DMA_HandleTypeDef hdma_usart3_tx;
DMA_HandleTypeDef hdma_usart6_rx;
DMA_HandleTypeDef hdma_usart6_tx;

PCD_HandleTypeDef hpcd_USB_OTG_FS;
PCD_HandleTypeDef hpcd_USB_OTG_HS;

NOR_HandleTypeDef hnor1;
SRAM_HandleTypeDef hsram2;
SDRAM_HandleTypeDef hsdram1;

/* Definitions for defaultTask */
osThreadId_t defaultTaskHandle;
const osThreadAttr_t defaultTask_attributes = {
  .name = "defaultTask",
  .priority = (osPriority_t) osPriorityNormal,
  .stack_size = 1024 * 4
};
/* Definitions for dynamicExampleQue */
osMessageQueueId_t dynamicExampleQueHandle;
const osMessageQueueAttr_t dynamicExampleQue_attributes = {
  .name = "dynamicExampleQue"
};
/* Definitions for staticExampleQue */
osMessageQueueId_t staticExampleQueHandle;
uint8_t staticExampleQueBuffer[ 16 * sizeof( uint32_t ) ];
osStaticMessageQDef_t staticExampleQueControlBlock;
const osMessageQueueAttr_t staticExampleQue_attributes = {
  .name = "staticExampleQue",
  .cb_mem = &staticExampleQueControlBlock,
  .cb_size = sizeof(staticExampleQueControlBlock),
  .mq_mem = &staticExampleQueBuffer,
  .mq_size = sizeof(staticExampleQueBuffer)
};
/* Definitions for dynamicExampleSema */
osSemaphoreId_t dynamicExampleSemaHandle;
const osSemaphoreAttr_t dynamicExampleSema_attributes = {
  .name = "dynamicExampleSema"
};
/* Definitions for staticExampleSema */
osSemaphoreId_t staticExampleSemaHandle;
osStaticSemaphoreDef_t staticExampleSemaControlBlock;
const osSemaphoreAttr_t staticExampleSema_attributes = {
  .name = "staticExampleSema",
  .cb_mem = &staticExampleSemaControlBlock,
  .cb_size = sizeof(staticExampleSemaControlBlock),
};

void SystemClock_Config(void);
static void MX_GPIO_Init(void);
static void MX_DMA_Init(void);
static void MX_DSIHOST_DSI_Init(void);
static void MX_ETH_Init(void);
static void MX_FMC_Init(void);
static void MX_I2C1_Init(void);
static void MX_LTDC_Init(void);
static void MX_SPI5_Init(void);
static void MX_USART1_UART_Init(void);
static void MX_USB_OTG_FS_PCD_Init(void);
static void MX_USB_OTG_HS_PCD_Init(void);
static void MX_UART4_Init(void);
static void MX_UART5_Init(void);
static void MX_UART8_Init(void);
static void MX_USART3_UART_Init(void);
static void MX_USART6_UART_Init(void);
void StartDefaultTask(void *argument);

int main(void)
{
  /* USER CODE BEGIN Boot_Mode_Sequence_0 */
    int32_t timeout;
  /* USER CODE END Boot_Mode_Sequence_0 */

/* USER CODE BEGIN Boot_Mode_Sequence_1 */
  /* Wait until CPU2 boots and enters in stop mode or timeout*/
  timeout = 0xFFFF;
  while((__HAL_RCC_GET_FLAG(RCC_FLAG_D2CKRDY) != RESET) && (timeout-- > 0));
  if ( timeout < 0 )
  {
  Error_Handler();
  }
/* USER CODE END Boot_Mode_Sequence_1 */
  /* MCU Configuration--------------------------------------------------------*/

  /* Reset of all peripherals, Initializes the Flash interface and the Systick. */
  HAL_Init();

  /* USER CODE BEGIN Init */
	test();
  /* USER CODE END Init */

  /* Configure the system clock */
  SystemClock_Config();
/* USER CODE BEGIN Boot_Mode_Sequence_2 */
/* When system initialization is finished, Cortex-M7 will release Cortex-M4 by means of
HSEM notification */
/*HW semaphore Clock enable*/
__HAL_RCC_HSEM_CLK_ENABLE();
/*Take HSEM */
HAL_HSEM_FastTake(HSEM_ID_0);
/*Release HSEM in order to notify the CPU2(CM4)*/
HAL_HSEM_Release(HSEM_ID_0,0);
/* wait until CPU2 wakes up from stop mode */
timeout = 0xFFFF;
while((__HAL_RCC_GET_FLAG(RCC_FLAG_D2CKRDY) == RESET) && (timeout-- > 0));
if ( timeout < 0 )
{
Error_Handler();
}
/* USER CODE END Boot_Mode_Sequence_2 */

  /* Initialize all configured peripherals */
  MX_GPIO_Init();
  MX_DMA_Init();
  MX_DSIHOST_DSI_Init();
  MX_ETH_Init();
  MX_FMC_Init();
  MX_I2C1_Init();
  MX_LTDC_Init();
  MX_SPI5_Init();
  MX_USART1_UART_Init();
  MX_USB_OTG_FS_PCD_Init();
  MX_USB_OTG_HS_PCD_Init();
  MX_UART4_Init();
  MX_UART5_Init();
  MX_UART8_Init();
  MX_USART3_UART_Init();
  MX_USART6_UART_Init();

  /* Init scheduler */
  osKernelInitialize();

  /* Create the semaphores(s) */
  /* creation of dynamicExampleSema */
  dynamicExampleSemaHandle = osSemaphoreNew(1, 1, &dynamicExampleSema_attributes);

  /* creation of staticExampleSema */
  staticExampleSemaHandle = osSemaphoreNew(1, 1, &staticExampleSema_attributes);

  /* Create the queue(s) */
  /* creation of dynamicExampleQue */
  dynamicExampleQueHandle = osMessageQueueNew (16, sizeof(uint32_t), &dynamicExampleQue_attributes);

  /* creation of staticExampleQue */
  staticExampleQueHandle = osMessageQueueNew (16, sizeof(uint32_t), &staticExampleQue_attributes);

  /* Create the thread(s) */
  /* creation of defaultTask */
  defaultTaskHandle = osThreadNew(StartDefaultTask, NULL, &defaultTask_attributes);

  /* Start scheduler */
  osKernelStart();

  /* We should never get here as control is now taken by the scheduler */
  /* Infinite loop */
  while (1)
  {

  }
}

void SystemClock_Config(void)
{
  RCC_OscInitTypeDef RCC_OscInitStruct = {0};
  RCC_ClkInitTypeDef RCC_ClkInitStruct = {0};
  RCC_PeriphCLKInitTypeDef PeriphClkInitStruct = {0};

  /** Supply configuration update enable
  */
  HAL_PWREx_ConfigSupply(PWR_DIRECT_SMPS_SUPPLY);
  /** Configure the main internal regulator output voltage
  */
  __HAL_PWR_VOLTAGESCALING_CONFIG(PWR_REGULATOR_VOLTAGE_SCALE1);

  while(!__HAL_PWR_GET_FLAG(PWR_FLAG_VOSRDY)) {}
  /** Macro to configure the PLL clock source
  */
  __HAL_RCC_PLL_PLLSOURCE_CONFIG(RCC_PLLSOURCE_HSE);
  /** Initializes the CPU, AHB and APB busses clocks
  */
  RCC_OscInitStruct.OscillatorType = RCC_OSCILLATORTYPE_HSI48|RCC_OSCILLATORTYPE_HSI
                              |RCC_OSCILLATORTYPE_HSE;
  RCC_OscInitStruct.HSEState = RCC_HSE_ON;
  RCC_OscInitStruct.HSIState = RCC_HSI_DIV1;
  RCC_OscInitStruct.HSICalibrationValue = RCC_HSICALIBRATION_DEFAULT;
  RCC_OscInitStruct.HSI48State = RCC_HSI48_ON;
  RCC_OscInitStruct.PLL.PLLState = RCC_PLL_ON;
  RCC_OscInitStruct.PLL.PLLSource = RCC_PLLSOURCE_HSE;
  RCC_OscInitStruct.PLL.PLLM = 2;
  RCC_OscInitStruct.PLL.PLLN = 64;
  RCC_OscInitStruct.PLL.PLLP = 2;
  RCC_OscInitStruct.PLL.PLLQ = 2;
  RCC_OscInitStruct.PLL.PLLR = 2;
  RCC_OscInitStruct.PLL.PLLRGE = RCC_PLL1VCIRANGE_3;
  RCC_OscInitStruct.PLL.PLLVCOSEL = RCC_PLL1VCOWIDE;
  RCC_OscInitStruct.PLL.PLLFRACN = 0;
  if (HAL_RCC_OscConfig(&RCC_OscInitStruct) != HAL_OK)
  {
    Error_Handler();
  }
  /** Initializes the CPU, AHB and APB busses clocks
  */
  RCC_ClkInitStruct.ClockType = RCC_CLOCKTYPE_HCLK|RCC_CLOCKTYPE_SYSCLK
                              |RCC_CLOCKTYPE_PCLK1|RCC_CLOCKTYPE_PCLK2
                              |RCC_CLOCKTYPE_D3PCLK1|RCC_CLOCKTYPE_D1PCLK1;
  RCC_ClkInitStruct.SYSCLKSource = RCC_SYSCLKSOURCE_PLLCLK;
  RCC_ClkInitStruct.SYSCLKDivider = RCC_SYSCLK_DIV1;
  RCC_ClkInitStruct.AHBCLKDivider = RCC_HCLK_DIV2;
  RCC_ClkInitStruct.APB3CLKDivider = RCC_APB3_DIV2;
  RCC_ClkInitStruct.APB1CLKDivider = RCC_APB1_DIV2;
  RCC_ClkInitStruct.APB2CLKDivider = RCC_APB2_DIV2;
  RCC_ClkInitStruct.APB4CLKDivider = RCC_APB4_DIV2;

  if (HAL_RCC_ClockConfig(&RCC_ClkInitStruct, FLASH_LATENCY_2) != HAL_OK)
  {
    Error_Handler();
  }
  PeriphClkInitStruct.PeriphClockSelection = RCC_PERIPHCLK_DSI|RCC_PERIPHCLK_LTDC
                              |RCC_PERIPHCLK_USART3|RCC_PERIPHCLK_UART4
                              |RCC_PERIPHCLK_USART6|RCC_PERIPHCLK_USART1
                              |RCC_PERIPHCLK_UART8|RCC_PERIPHCLK_UART5
                              |RCC_PERIPHCLK_SPI5|RCC_PERIPHCLK_I2C1
                              |RCC_PERIPHCLK_USB|RCC_PERIPHCLK_FMC;
  PeriphClkInitStruct.PLL3.PLL3M = 32;
  PeriphClkInitStruct.PLL3.PLL3N = 129;
  PeriphClkInitStruct.PLL3.PLL3P = 2;
  PeriphClkInitStruct.PLL3.PLL3Q = 2;
  PeriphClkInitStruct.PLL3.PLL3R = 2;
  PeriphClkInitStruct.PLL3.PLL3RGE = RCC_PLL3VCIRANGE_3;
  PeriphClkInitStruct.PLL3.PLL3VCOSEL = RCC_PLL3VCOWIDE;
  PeriphClkInitStruct.PLL3.PLL3FRACN = 0;
  PeriphClkInitStruct.FmcClockSelection = RCC_FMCCLKSOURCE_D1HCLK;
  PeriphClkInitStruct.DsiClockSelection = RCC_DSICLKSOURCE_PHY;
  PeriphClkInitStruct.Spi45ClockSelection = RCC_SPI45CLKSOURCE_D2PCLK1;
  PeriphClkInitStruct.Usart234578ClockSelection = RCC_USART234578CLKSOURCE_D2PCLK1;
  PeriphClkInitStruct.Usart16ClockSelection = RCC_USART16CLKSOURCE_D2PCLK2;
  PeriphClkInitStruct.I2c123ClockSelection = RCC_I2C123CLKSOURCE_D2PCLK1;
  PeriphClkInitStruct.UsbClockSelection = RCC_USBCLKSOURCE_HSI48;
  if (HAL_RCCEx_PeriphCLKConfig(&PeriphClkInitStruct) != HAL_OK)
  {
    Error_Handler();
  }
  HAL_RCC_MCOConfig(RCC_MCO1, RCC_MCO1SOURCE_HSI, RCC_MCODIV_10);
  /** Enable USB Voltage detector
  */
  HAL_PWREx_EnableUSBVoltageDetector();
}

static void MX_DSIHOST_DSI_Init(void)
{

  DSI_PLLInitTypeDef PLLInit = {0};
  DSI_HOST_TimeoutTypeDef HostTimeouts = {0};
  DSI_PHY_TimerTypeDef PhyTimings = {0};
  DSI_LPCmdTypeDef LPCmd = {0};
  DSI_CmdCfgTypeDef CmdCfg = {0};

  hdsi.Instance = DSI;
  hdsi.Init.AutomaticClockLaneControl = DSI_AUTO_CLK_LANE_CTRL_DISABLE;
  hdsi.Init.TXEscapeCkdiv = 2;
  hdsi.Init.NumberOfLanes = DSI_ONE_DATA_LANE;
  PLLInit.PLLNDIV = 10;
  PLLInit.PLLIDF = DSI_PLL_IN_DIV1;
  PLLInit.PLLODF = DSI_PLL_OUT_DIV1;
  if (HAL_DSI_Init(&hdsi, &PLLInit) != HAL_OK)
  {
    Error_Handler();
  }
  HostTimeouts.TimeoutCkdiv = 1;
  HostTimeouts.HighSpeedTransmissionTimeout = 0;
  HostTimeouts.LowPowerReceptionTimeout = 0;
  HostTimeouts.HighSpeedReadTimeout = 0;
  HostTimeouts.LowPowerReadTimeout = 0;
  HostTimeouts.HighSpeedWriteTimeout = 0;
  HostTimeouts.HighSpeedWritePrespMode = DSI_HS_PM_DISABLE;
  HostTimeouts.LowPowerWriteTimeout = 0;
  HostTimeouts.BTATimeout = 0;
  if (HAL_DSI_ConfigHostTimeouts(&hdsi, &HostTimeouts) != HAL_OK)
  {
    Error_Handler();
  }
  PhyTimings.ClockLaneHS2LPTime = 20;
  PhyTimings.ClockLaneLP2HSTime = 18;
  PhyTimings.DataLaneHS2LPTime = 10;
  PhyTimings.DataLaneLP2HSTime = 13;
  PhyTimings.DataLaneMaxReadTime = 0;
  PhyTimings.StopWaitTime = 0;
  if (HAL_DSI_ConfigPhyTimer(&hdsi, &PhyTimings) != HAL_OK)
  {
    Error_Handler();
  }
  if (HAL_DSI_ConfigFlowControl(&hdsi, DSI_FLOW_CONTROL_BTA) != HAL_OK)
  {
    Error_Handler();
  }
  if (HAL_DSI_SetLowPowerRXFilter(&hdsi, 10000) != HAL_OK)
  {
    Error_Handler();
  }
  if (HAL_DSI_ConfigErrorMonitor(&hdsi, HAL_DSI_ERROR_NONE) != HAL_OK)
  {
    Error_Handler();
  }
  LPCmd.LPGenShortWriteNoP = DSI_LP_GSW0P_DISABLE;
  LPCmd.LPGenShortWriteOneP = DSI_LP_GSW1P_DISABLE;
  LPCmd.LPGenShortWriteTwoP = DSI_LP_GSW2P_DISABLE;
  LPCmd.LPGenShortReadNoP = DSI_LP_GSR0P_DISABLE;
  LPCmd.LPGenShortReadOneP = DSI_LP_GSR1P_DISABLE;
  LPCmd.LPGenShortReadTwoP = DSI_LP_GSR2P_DISABLE;
  LPCmd.LPGenLongWrite = DSI_LP_GLW_DISABLE;
  LPCmd.LPDcsShortWriteNoP = DSI_LP_DSW0P_DISABLE;
  LPCmd.LPDcsShortWriteOneP = DSI_LP_DSW1P_DISABLE;
  LPCmd.LPDcsShortReadNoP = DSI_LP_DSR0P_DISABLE;
  LPCmd.LPDcsLongWrite = DSI_LP_DLW_DISABLE;
  LPCmd.LPMaxReadPacket = DSI_LP_MRDP_DISABLE;
  LPCmd.AcknowledgeRequest = DSI_ACKNOWLEDGE_DISABLE;
  if (HAL_DSI_ConfigCommand(&hdsi, &LPCmd) != HAL_OK)
  {
    Error_Handler();
  }
  CmdCfg.VirtualChannelID = 0;
  CmdCfg.ColorCoding = DSI_RGB888;
  CmdCfg.CommandSize = 640;
  CmdCfg.TearingEffectSource = DSI_TE_EXTERNAL;
  CmdCfg.TearingEffectPolarity = DSI_TE_RISING_EDGE;
  CmdCfg.HSPolarity = DSI_HSYNC_ACTIVE_LOW;
  CmdCfg.VSPolarity = DSI_VSYNC_ACTIVE_LOW;
  CmdCfg.DEPolarity = DSI_DATA_ENABLE_ACTIVE_HIGH;
  CmdCfg.VSyncPol = DSI_VSYNC_FALLING;
  CmdCfg.AutomaticRefresh = DSI_AR_ENABLE;
  CmdCfg.TEAcknowledgeRequest = DSI_TE_ACKNOWLEDGE_DISABLE;
  if (HAL_DSI_ConfigAdaptedCommandMode(&hdsi, &CmdCfg) != HAL_OK)
  {
    Error_Handler();
  }
  if (HAL_DSI_SetGenericVCID(&hdsi, 0) != HAL_OK)
  {
    Error_Handler();
  }

}

static void MX_ETH_Init(void)
{

  heth.Instance = ETH;
  heth.Init.MACAddr[0] =   0x00;
  heth.Init.MACAddr[1] =   0x80;
  heth.Init.MACAddr[2] =   0xE1;
  heth.Init.MACAddr[3] =   0x00;
  heth.Init.MACAddr[4] =   0x00;
  heth.Init.MACAddr[5] =   0x00;
  heth.Init.MediaInterface = HAL_ETH_RMII_MODE;
  heth.Init.TxDesc = DMATxDscrTab;
  heth.Init.RxDesc = DMARxDscrTab;
  heth.Init.RxBuffLen = 1524;

  if (HAL_ETH_Init(&heth) != HAL_OK)
  {
    Error_Handler();
  }

  memset(&TxConfig, 0 , sizeof(ETH_TxPacketConfig));
  TxConfig.Attributes = ETH_TX_PACKETS_FEATURES_CSUM | ETH_TX_PACKETS_FEATURES_CRCPAD;
  TxConfig.ChecksumCtrl = ETH_CHECKSUM_IPHDR_PAYLOAD_INSERT_PHDR_CALC;
  TxConfig.CRCPadCtrl = ETH_CRC_PAD_INSERT;

}

static void MX_I2C1_Init(void)
{

  hi2c1.Instance = I2C1;
  hi2c1.Init.Timing = 0x10C0ECFF;
  hi2c1.Init.OwnAddress1 = 0;
  hi2c1.Init.AddressingMode = I2C_ADDRESSINGMODE_7BIT;
  hi2c1.Init.DualAddressMode = I2C_DUALADDRESS_DISABLE;
  hi2c1.Init.OwnAddress2 = 0;
  hi2c1.Init.OwnAddress2Masks = I2C_OA2_NOMASK;
  hi2c1.Init.GeneralCallMode = I2C_GENERALCALL_DISABLE;
  hi2c1.Init.NoStretchMode = I2C_NOSTRETCH_DISABLE;
  if (HAL_I2C_Init(&hi2c1) != HAL_OK)
  {
    Error_Handler();
  }
  /** Configure Analogue filter
  */
  if (HAL_I2CEx_ConfigAnalogFilter(&hi2c1, I2C_ANALOGFILTER_ENABLE) != HAL_OK)
  {
    Error_Handler();
  }
  /** Configure Digital filter
  */
  if (HAL_I2CEx_ConfigDigitalFilter(&hi2c1, 0) != HAL_OK)
  {
    Error_Handler();
  }

}

static void MX_LTDC_Init(void)
{

  LTDC_LayerCfgTypeDef pLayerCfg = {0};
  LTDC_LayerCfgTypeDef pLayerCfg1 = {0};

  hltdc.Instance = LTDC;
  hltdc.Init.HSPolarity = LTDC_HSPOLARITY_AL;
  hltdc.Init.VSPolarity = LTDC_VSPOLARITY_AL;
  hltdc.Init.DEPolarity = LTDC_DEPOLARITY_AL;
  hltdc.Init.PCPolarity = LTDC_PCPOLARITY_IPC;
  hltdc.Init.HorizontalSync = 7;
  hltdc.Init.VerticalSync = 3;
  hltdc.Init.AccumulatedHBP = 14;
  hltdc.Init.AccumulatedVBP = 5;
  hltdc.Init.AccumulatedActiveW = 654;
  hltdc.Init.AccumulatedActiveH = 485;
  hltdc.Init.TotalWidth = 660;
  hltdc.Init.TotalHeigh = 487;
  hltdc.Init.Backcolor.Blue = 0;
  hltdc.Init.Backcolor.Green = 0;
  hltdc.Init.Backcolor.Red = 0;
  if (HAL_LTDC_Init(&hltdc) != HAL_OK)
  {
    Error_Handler();
  }
  pLayerCfg.WindowX0 = 0;
  pLayerCfg.WindowX1 = 0;
  pLayerCfg.WindowY0 = 0;
  pLayerCfg.WindowY1 = 0;
  pLayerCfg.PixelFormat = LTDC_PIXEL_FORMAT_ARGB8888;
  pLayerCfg.Alpha = 0;
  pLayerCfg.Alpha0 = 0;
  pLayerCfg.BlendingFactor1 = LTDC_BLENDING_FACTOR1_CA;
  pLayerCfg.BlendingFactor2 = LTDC_BLENDING_FACTOR2_CA;
  pLayerCfg.FBStartAdress = 0;
  pLayerCfg.ImageWidth = 0;
  pLayerCfg.ImageHeight = 0;
  pLayerCfg.Backcolor.Blue = 0;
  pLayerCfg.Backcolor.Green = 0;
  pLayerCfg.Backcolor.Red = 0;
  if (HAL_LTDC_ConfigLayer(&hltdc, &pLayerCfg, 0) != HAL_OK)
  {
    Error_Handler();
  }
  pLayerCfg1.WindowX0 = 0;
  pLayerCfg1.WindowX1 = 0;
  pLayerCfg1.WindowY0 = 0;
  pLayerCfg1.WindowY1 = 0;
  pLayerCfg1.PixelFormat = LTDC_PIXEL_FORMAT_ARGB8888;
  pLayerCfg1.Alpha = 0;
  pLayerCfg1.Alpha0 = 0;
  pLayerCfg1.BlendingFactor1 = LTDC_BLENDING_FACTOR1_CA;
  pLayerCfg1.BlendingFactor2 = LTDC_BLENDING_FACTOR2_CA;
  pLayerCfg1.FBStartAdress = 0;
  pLayerCfg1.ImageWidth = 0;
  pLayerCfg1.ImageHeight = 0;
  pLayerCfg1.Backcolor.Blue = 0;
  pLayerCfg1.Backcolor.Green = 0;
  pLayerCfg1.Backcolor.Red = 0;
  if (HAL_LTDC_ConfigLayer(&hltdc, &pLayerCfg1, 1) != HAL_OK)
  {
    Error_Handler();
  }

}

static void MX_SPI5_Init(void)
{

  /* SPI5 parameter configuration*/
  hspi5.Instance = SPI5;
  hspi5.Init.Mode = SPI_MODE_MASTER;
  hspi5.Init.Direction = SPI_DIRECTION_2LINES;
  hspi5.Init.DataSize = SPI_DATASIZE_4BIT;
  hspi5.Init.CLKPolarity = SPI_POLARITY_LOW;
  hspi5.Init.CLKPhase = SPI_PHASE_1EDGE;
  hspi5.Init.NSS = SPI_NSS_HARD_OUTPUT;
  hspi5.Init.BaudRatePrescaler = SPI_BAUDRATEPRESCALER_2;
  hspi5.Init.FirstBit = SPI_FIRSTBIT_MSB;
  hspi5.Init.TIMode = SPI_TIMODE_DISABLE;
  hspi5.Init.CRCCalculation = SPI_CRCCALCULATION_DISABLE;
  hspi5.Init.CRCPolynomial = 0x0;
  hspi5.Init.NSSPMode = SPI_NSS_PULSE_ENABLE;
  hspi5.Init.NSSPolarity = SPI_NSS_POLARITY_LOW;
  hspi5.Init.FifoThreshold = SPI_FIFO_THRESHOLD_01DATA;
  hspi5.Init.TxCRCInitializationPattern = SPI_CRC_INITIALIZATION_ALL_ZERO_PATTERN;
  hspi5.Init.RxCRCInitializationPattern = SPI_CRC_INITIALIZATION_ALL_ZERO_PATTERN;
  hspi5.Init.MasterSSIdleness = SPI_MASTER_SS_IDLENESS_00CYCLE;
  hspi5.Init.MasterInterDataIdleness = SPI_MASTER_INTERDATA_IDLENESS_00CYCLE;
  hspi5.Init.MasterReceiverAutoSusp = SPI_MASTER_RX_AUTOSUSP_DISABLE;
  hspi5.Init.MasterKeepIOState = SPI_MASTER_KEEP_IO_STATE_DISABLE;
  hspi5.Init.IOSwap = SPI_IO_SWAP_DISABLE;
  if (HAL_SPI_Init(&hspi5) != HAL_OK)
  {
    Error_Handler();
  }

}

static void MX_UART4_Init(void)
{

  huart4.Instance = UART4;
  huart4.Init.BaudRate = 115200;
  huart4.Init.WordLength = UART_WORDLENGTH_8B;
  huart4.Init.StopBits = UART_STOPBITS_1;
  huart4.Init.Parity = UART_PARITY_NONE;
  huart4.Init.Mode = UART_MODE_TX_RX;
  huart4.Init.HwFlowCtl = UART_HWCONTROL_NONE;
  huart4.Init.OverSampling = UART_OVERSAMPLING_16;
  huart4.Init.OneBitSampling = UART_ONE_BIT_SAMPLE_DISABLE;
  huart4.Init.ClockPrescaler = UART_PRESCALER_DIV1;
  huart4.AdvancedInit.AdvFeatureInit = UART_ADVFEATURE_NO_INIT;
  if (HAL_UART_Init(&huart4) != HAL_OK)
  {
    Error_Handler();
  }
  if (HAL_UARTEx_SetTxFifoThreshold(&huart4, UART_TXFIFO_THRESHOLD_1_8) != HAL_OK)
  {
    Error_Handler();
  }
  if (HAL_UARTEx_SetRxFifoThreshold(&huart4, UART_RXFIFO_THRESHOLD_1_8) != HAL_OK)
  {
    Error_Handler();
  }
  if (HAL_UARTEx_DisableFifoMode(&huart4) != HAL_OK)
  {
    Error_Handler();
  }

}

static void MX_UART5_Init(void)
{

  huart5.Instance = UART5;
  huart5.Init.BaudRate = 115200;
  huart5.Init.WordLength = UART_WORDLENGTH_8B;
  huart5.Init.StopBits = UART_STOPBITS_1;
  huart5.Init.Parity = UART_PARITY_NONE;
  huart5.Init.Mode = UART_MODE_TX_RX;
  huart5.Init.HwFlowCtl = UART_HWCONTROL_NONE;
  huart5.Init.OverSampling = UART_OVERSAMPLING_16;
  huart5.Init.OneBitSampling = UART_ONE_BIT_SAMPLE_DISABLE;
  huart5.Init.ClockPrescaler = UART_PRESCALER_DIV1;
  huart5.AdvancedInit.AdvFeatureInit = UART_ADVFEATURE_NO_INIT;
  if (HAL_UART_Init(&huart5) != HAL_OK)
  {
    Error_Handler();
  }
  if (HAL_UARTEx_SetTxFifoThreshold(&huart5, UART_TXFIFO_THRESHOLD_1_8) != HAL_OK)
  {
    Error_Handler();
  }
  if (HAL_UARTEx_SetRxFifoThreshold(&huart5, UART_RXFIFO_THRESHOLD_1_8) != HAL_OK)
  {
    Error_Handler();
  }
  if (HAL_UARTEx_DisableFifoMode(&huart5) != HAL_OK)
  {
    Error_Handler();
  }

}

static void MX_UART8_Init(void)
{

  huart8.Instance = UART8;
  huart8.Init.BaudRate = 115200;
  huart8.Init.WordLength = UART_WORDLENGTH_8B;
  huart8.Init.StopBits = UART_STOPBITS_1;
  huart8.Init.Parity = UART_PARITY_NONE;
  huart8.Init.Mode = UART_MODE_TX_RX;
  huart8.Init.HwFlowCtl = UART_HWCONTROL_NONE;
  huart8.Init.OverSampling = UART_OVERSAMPLING_16;
  huart8.Init.OneBitSampling = UART_ONE_BIT_SAMPLE_DISABLE;
  huart8.Init.ClockPrescaler = UART_PRESCALER_DIV1;
  huart8.AdvancedInit.AdvFeatureInit = UART_ADVFEATURE_NO_INIT;
  if (HAL_UART_Init(&huart8) != HAL_OK)
  {
    Error_Handler();
  }
  if (HAL_UARTEx_SetTxFifoThreshold(&huart8, UART_TXFIFO_THRESHOLD_1_8) != HAL_OK)
  {
    Error_Handler();
  }
  if (HAL_UARTEx_SetRxFifoThreshold(&huart8, UART_RXFIFO_THRESHOLD_1_8) != HAL_OK)
  {
    Error_Handler();
  }
  if (HAL_UARTEx_DisableFifoMode(&huart8) != HAL_OK)
  {
    Error_Handler();
  }

}

static void MX_USART1_UART_Init(void)
{

  huart1.Instance = USART1;
  huart1.Init.BaudRate = 115200;
  huart1.Init.WordLength = UART_WORDLENGTH_8B;
  huart1.Init.StopBits = UART_STOPBITS_1;
  huart1.Init.Parity = UART_PARITY_NONE;
  huart1.Init.Mode = UART_MODE_TX_RX;
  huart1.Init.HwFlowCtl = UART_HWCONTROL_NONE;
  huart1.Init.OverSampling = UART_OVERSAMPLING_16;
  huart1.Init.OneBitSampling = UART_ONE_BIT_SAMPLE_DISABLE;
  huart1.Init.ClockPrescaler = UART_PRESCALER_DIV1;
  huart1.AdvancedInit.AdvFeatureInit = UART_ADVFEATURE_NO_INIT;
  if (HAL_UART_Init(&huart1) != HAL_OK)
  {
    Error_Handler();
  }
  if (HAL_UARTEx_SetTxFifoThreshold(&huart1, UART_TXFIFO_THRESHOLD_1_8) != HAL_OK)
  {
    Error_Handler();
  }
  if (HAL_UARTEx_SetRxFifoThreshold(&huart1, UART_RXFIFO_THRESHOLD_1_8) != HAL_OK)
  {
    Error_Handler();
  }
  if (HAL_UARTEx_DisableFifoMode(&huart1) != HAL_OK)
  {
    Error_Handler();
  }

}

static void MX_USART3_UART_Init(void)
{

  huart3.Instance = USART3;
  huart3.Init.BaudRate = 115200;
  huart3.Init.WordLength = UART_WORDLENGTH_8B;
  huart3.Init.StopBits = UART_STOPBITS_1;
  huart3.Init.Parity = UART_PARITY_NONE;
  huart3.Init.Mode = UART_MODE_TX_RX;
  huart3.Init.HwFlowCtl = UART_HWCONTROL_NONE;
  huart3.Init.OverSampling = UART_OVERSAMPLING_16;
  huart3.Init.OneBitSampling = UART_ONE_BIT_SAMPLE_DISABLE;
  huart3.Init.ClockPrescaler = UART_PRESCALER_DIV1;
  huart3.AdvancedInit.AdvFeatureInit = UART_ADVFEATURE_NO_INIT;
  if (HAL_UART_Init(&huart3) != HAL_OK)
  {
    Error_Handler();
  }
  if (HAL_UARTEx_SetTxFifoThreshold(&huart3, UART_TXFIFO_THRESHOLD_1_8) != HAL_OK)
  {
    Error_Handler();
  }
  if (HAL_UARTEx_SetRxFifoThreshold(&huart3, UART_RXFIFO_THRESHOLD_1_8) != HAL_OK)
  {
    Error_Handler();
  }
  if (HAL_UARTEx_DisableFifoMode(&huart3) != HAL_OK)
  {
    Error_Handler();
  }

}

static void MX_USART6_UART_Init(void)
{

  huart6.Instance = USART6;
  huart6.Init.BaudRate = 115200;
  huart6.Init.WordLength = UART_WORDLENGTH_8B;
  huart6.Init.StopBits = UART_STOPBITS_1;
  huart6.Init.Parity = UART_PARITY_NONE;
  huart6.Init.Mode = UART_MODE_TX_RX;
  huart6.Init.HwFlowCtl = UART_HWCONTROL_NONE;
  huart6.Init.OverSampling = UART_OVERSAMPLING_16;
  huart6.Init.OneBitSampling = UART_ONE_BIT_SAMPLE_DISABLE;
  huart6.Init.ClockPrescaler = UART_PRESCALER_DIV1;
  huart6.AdvancedInit.AdvFeatureInit = UART_ADVFEATURE_NO_INIT;
  if (HAL_UART_Init(&huart6) != HAL_OK)
  {
    Error_Handler();
  }
  if (HAL_UARTEx_SetTxFifoThreshold(&huart6, UART_TXFIFO_THRESHOLD_1_8) != HAL_OK)
  {
    Error_Handler();
  }
  if (HAL_UARTEx_SetRxFifoThreshold(&huart6, UART_RXFIFO_THRESHOLD_1_8) != HAL_OK)
  {
    Error_Handler();
  }
  if (HAL_UARTEx_DisableFifoMode(&huart6) != HAL_OK)
  {
    Error_Handler();
  }

}

static void MX_USB_OTG_FS_PCD_Init(void)
{

  hpcd_USB_OTG_FS.Instance = USB_OTG_FS;
  hpcd_USB_OTG_FS.Init.dev_endpoints = 9;
  hpcd_USB_OTG_FS.Init.speed = PCD_SPEED_FULL;
  hpcd_USB_OTG_FS.Init.dma_enable = DISABLE;
  hpcd_USB_OTG_FS.Init.phy_itface = PCD_PHY_EMBEDDED;
  hpcd_USB_OTG_FS.Init.Sof_enable = DISABLE;
  hpcd_USB_OTG_FS.Init.low_power_enable = DISABLE;
  hpcd_USB_OTG_FS.Init.lpm_enable = DISABLE;
  hpcd_USB_OTG_FS.Init.battery_charging_enable = ENABLE;
  hpcd_USB_OTG_FS.Init.vbus_sensing_enable = ENABLE;
  hpcd_USB_OTG_FS.Init.use_dedicated_ep1 = DISABLE;
  if (HAL_PCD_Init(&hpcd_USB_OTG_FS) != HAL_OK)
  {
    Error_Handler();
  }

}

static void MX_USB_OTG_HS_PCD_Init(void)
{

  hpcd_USB_OTG_HS.Instance = USB_OTG_HS;
  hpcd_USB_OTG_HS.Init.dev_endpoints = 9;
  hpcd_USB_OTG_HS.Init.speed = PCD_SPEED_HIGH;
  hpcd_USB_OTG_HS.Init.dma_enable = DISABLE;
  hpcd_USB_OTG_HS.Init.phy_itface = USB_OTG_ULPI_PHY;
  hpcd_USB_OTG_HS.Init.Sof_enable = DISABLE;
  hpcd_USB_OTG_HS.Init.low_power_enable = DISABLE;
  hpcd_USB_OTG_HS.Init.lpm_enable = DISABLE;
  hpcd_USB_OTG_HS.Init.battery_charging_enable = ENABLE;
  hpcd_USB_OTG_HS.Init.vbus_sensing_enable = DISABLE;
  hpcd_USB_OTG_HS.Init.use_dedicated_ep1 = DISABLE;
  hpcd_USB_OTG_HS.Init.use_external_vbus = DISABLE;
  if (HAL_PCD_Init(&hpcd_USB_OTG_HS) != HAL_OK)
  {
    Error_Handler();
  }

}

static void MX_DMA_Init(void)
{

  /* DMA controller clock enable */
  __HAL_RCC_DMA1_CLK_ENABLE();
  __HAL_RCC_DMA2_CLK_ENABLE();

  /* DMA interrupt init */
  /* DMA1_Stream0_IRQn interrupt configuration */
  HAL_NVIC_SetPriority(DMA1_Stream0_IRQn, 5, 0);
  HAL_NVIC_EnableIRQ(DMA1_Stream0_IRQn);
  /* DMA1_Stream1_IRQn interrupt configuration */
  HAL_NVIC_SetPriority(DMA1_Stream1_IRQn, 5, 0);
  HAL_NVIC_EnableIRQ(DMA1_Stream1_IRQn);
  /* DMA1_Stream2_IRQn interrupt configuration */
  HAL_NVIC_SetPriority(DMA1_Stream2_IRQn, 5, 0);
  HAL_NVIC_EnableIRQ(DMA1_Stream2_IRQn);
  /* DMA1_Stream3_IRQn interrupt configuration */
  HAL_NVIC_SetPriority(DMA1_Stream3_IRQn, 5, 0);
  HAL_NVIC_EnableIRQ(DMA1_Stream3_IRQn);
  /* DMA1_Stream4_IRQn interrupt configuration */
  HAL_NVIC_SetPriority(DMA1_Stream4_IRQn, 5, 0);
  HAL_NVIC_EnableIRQ(DMA1_Stream4_IRQn);
  /* DMA1_Stream5_IRQn interrupt configuration */
  HAL_NVIC_SetPriority(DMA1_Stream5_IRQn, 5, 0);
  HAL_NVIC_EnableIRQ(DMA1_Stream5_IRQn);
  /* DMA1_Stream6_IRQn interrupt configuration */
  HAL_NVIC_SetPriority(DMA1_Stream6_IRQn, 5, 0);
  HAL_NVIC_EnableIRQ(DMA1_Stream6_IRQn);
  /* DMA1_Stream7_IRQn interrupt configuration */
  HAL_NVIC_SetPriority(DMA1_Stream7_IRQn, 5, 0);
  HAL_NVIC_EnableIRQ(DMA1_Stream7_IRQn);
  /* DMA2_Stream0_IRQn interrupt configuration */
  HAL_NVIC_SetPriority(DMA2_Stream0_IRQn, 5, 0);
  HAL_NVIC_EnableIRQ(DMA2_Stream0_IRQn);
  /* DMA2_Stream1_IRQn interrupt configuration */
  HAL_NVIC_SetPriority(DMA2_Stream1_IRQn, 5, 0);
  HAL_NVIC_EnableIRQ(DMA2_Stream1_IRQn);
  /* DMA2_Stream2_IRQn interrupt configuration */
  HAL_NVIC_SetPriority(DMA2_Stream2_IRQn, 5, 0);
  HAL_NVIC_EnableIRQ(DMA2_Stream2_IRQn);
  /* DMA2_Stream3_IRQn interrupt configuration */
  HAL_NVIC_SetPriority(DMA2_Stream3_IRQn, 5, 0);
  HAL_NVIC_EnableIRQ(DMA2_Stream3_IRQn);

}

/* FMC initialization function */
void MX_FMC_Init(void)
{

  FMC_NORSRAM_TimingTypeDef Timing = {0};
  FMC_SDRAM_TimingTypeDef SdramTiming = {0};

  /** Perform the NOR1 memory initialization sequence
  */
  hnor1.Instance = FMC_NORSRAM_DEVICE;
  hnor1.Extended = FMC_NORSRAM_EXTENDED_DEVICE;
  /* hnor1.Init */
  hnor1.Init.NSBank = FMC_NORSRAM_BANK1;
  hnor1.Init.DataAddressMux = FMC_DATA_ADDRESS_MUX_DISABLE;
  hnor1.Init.MemoryType = FMC_MEMORY_TYPE_NOR;
  hnor1.Init.MemoryDataWidth = FMC_NORSRAM_MEM_BUS_WIDTH_16;
  hnor1.Init.BurstAccessMode = FMC_BURST_ACCESS_MODE_DISABLE;
  hnor1.Init.WaitSignalPolarity = FMC_WAIT_SIGNAL_POLARITY_LOW;
  hnor1.Init.WaitSignalActive = FMC_WAIT_TIMING_BEFORE_WS;
  hnor1.Init.WriteOperation = FMC_WRITE_OPERATION_DISABLE;
  hnor1.Init.WaitSignal = FMC_WAIT_SIGNAL_DISABLE;
  hnor1.Init.ExtendedMode = FMC_EXTENDED_MODE_DISABLE;
  hnor1.Init.AsynchronousWait = FMC_ASYNCHRONOUS_WAIT_ENABLE;
  hnor1.Init.WriteBurst = FMC_WRITE_BURST_DISABLE;
  hnor1.Init.ContinuousClock = FMC_CONTINUOUS_CLOCK_SYNC_ONLY;
  hnor1.Init.WriteFifo = FMC_WRITE_FIFO_ENABLE;
  hnor1.Init.PageSize = FMC_PAGE_SIZE_NONE;
  /* Timing */
  Timing.AddressSetupTime = 15;
  Timing.AddressHoldTime = 15;
  Timing.DataSetupTime = 255;
  Timing.BusTurnAroundDuration = 15;
  Timing.CLKDivision = 16;
  Timing.DataLatency = 17;
  Timing.AccessMode = FMC_ACCESS_MODE_A;
  /* ExtTiming */

  if (HAL_NOR_Init(&hnor1, &Timing, NULL) != HAL_OK)
  {
    Error_Handler( );
  }

  /** Perform the SRAM2 memory initialization sequence
  */
  hsram2.Instance = FMC_NORSRAM_DEVICE;
  hsram2.Extended = FMC_NORSRAM_EXTENDED_DEVICE;
  /* hsram2.Init */
  hsram2.Init.NSBank = FMC_NORSRAM_BANK3;
  hsram2.Init.DataAddressMux = FMC_DATA_ADDRESS_MUX_DISABLE;
  hsram2.Init.MemoryType = FMC_MEMORY_TYPE_SRAM;
  hsram2.Init.MemoryDataWidth = FMC_NORSRAM_MEM_BUS_WIDTH_16;
  hsram2.Init.BurstAccessMode = FMC_BURST_ACCESS_MODE_DISABLE;
  hsram2.Init.WaitSignalPolarity = FMC_WAIT_SIGNAL_POLARITY_LOW;
  hsram2.Init.WaitSignalActive = FMC_WAIT_TIMING_BEFORE_WS;
  hsram2.Init.WriteOperation = FMC_WRITE_OPERATION_DISABLE;
  hsram2.Init.WaitSignal = FMC_WAIT_SIGNAL_DISABLE;
  hsram2.Init.ExtendedMode = FMC_EXTENDED_MODE_DISABLE;
  hsram2.Init.AsynchronousWait = FMC_ASYNCHRONOUS_WAIT_ENABLE;
  hsram2.Init.WriteBurst = FMC_WRITE_BURST_DISABLE;
  hsram2.Init.ContinuousClock = FMC_CONTINUOUS_CLOCK_SYNC_ONLY;
  hsram2.Init.WriteFifo = FMC_WRITE_FIFO_ENABLE;
  hsram2.Init.PageSize = FMC_PAGE_SIZE_NONE;
  /* Timing */
  Timing.AddressSetupTime = 15;
  Timing.AddressHoldTime = 15;
  Timing.DataSetupTime = 255;
  Timing.BusTurnAroundDuration = 15;
  Timing.CLKDivision = 16;
  Timing.DataLatency = 17;
  Timing.AccessMode = FMC_ACCESS_MODE_A;
  /* ExtTiming */

  if (HAL_SRAM_Init(&hsram2, &Timing, NULL) != HAL_OK)
  {
    Error_Handler( );
  }

  /** Perform the SDRAM1 memory initialization sequence
  */
  hsdram1.Instance = FMC_SDRAM_DEVICE;
  /* hsdram1.Init */
  hsdram1.Init.SDBank = FMC_SDRAM_BANK2;
  hsdram1.Init.ColumnBitsNumber = FMC_SDRAM_COLUMN_BITS_NUM_8;
  hsdram1.Init.RowBitsNumber = FMC_SDRAM_ROW_BITS_NUM_11;
  hsdram1.Init.MemoryDataWidth = FMC_SDRAM_MEM_BUS_WIDTH_32;
  hsdram1.Init.InternalBankNumber = FMC_SDRAM_INTERN_BANKS_NUM_4;
  hsdram1.Init.CASLatency = FMC_SDRAM_CAS_LATENCY_1;
  hsdram1.Init.WriteProtection = FMC_SDRAM_WRITE_PROTECTION_DISABLE;
  hsdram1.Init.SDClockPeriod = FMC_SDRAM_CLOCK_DISABLE;
  hsdram1.Init.ReadBurst = FMC_SDRAM_RBURST_DISABLE;
  hsdram1.Init.ReadPipeDelay = FMC_SDRAM_RPIPE_DELAY_0;
  /* SdramTiming */
  SdramTiming.LoadToActiveDelay = 16;
  SdramTiming.ExitSelfRefreshDelay = 16;
  SdramTiming.SelfRefreshTime = 16;
  SdramTiming.RowCycleDelay = 16;
  SdramTiming.WriteRecoveryTime = 16;
  SdramTiming.RPDelay = 16;
  SdramTiming.RCDDelay = 16;

  if (HAL_SDRAM_Init(&hsdram1, &SdramTiming) != HAL_OK)
  {
    Error_Handler( );
  }

}

static void MX_GPIO_Init(void)
{
  GPIO_InitTypeDef GPIO_InitStruct = {0};

  /* GPIO Ports Clock Enable */
  __HAL_RCC_GPIOI_CLK_ENABLE();
  __HAL_RCC_GPIOB_CLK_ENABLE();
  __HAL_RCC_GPIOK_CLK_ENABLE();
  __HAL_RCC_GPIOG_CLK_ENABLE();
  __HAL_RCC_GPIOD_CLK_ENABLE();
  __HAL_RCC_GPIOC_CLK_ENABLE();
  __HAL_RCC_GPIOA_CLK_ENABLE();
  __HAL_RCC_GPIOE_CLK_ENABLE();
  __HAL_RCC_GPIOH_CLK_ENABLE();
  __HAL_RCC_GPIOF_CLK_ENABLE();
  __HAL_RCC_GPIOJ_CLK_ENABLE();

  /*Configure GPIO pin Output Level */
  HAL_GPIO_WritePin(GPIOK, LD3_Pin|LD2_Pin|LD4_Pin|LD1_Pin
                          |eINC_DAT_CMD_Pin, GPIO_PIN_RESET);

  /*Configure GPIO pin Output Level */
  HAL_GPIO_WritePin(eINK_RST_GPIO_Port, eINK_RST_Pin, GPIO_PIN_RESET);

  /*Configure GPIO pin Output Level */
  HAL_GPIO_WritePin(eINK_BUSY_GPIO_Port, eINK_BUSY_Pin, GPIO_PIN_RESET);

  /*Configure GPIO pins : LD3_Pin LD2_Pin LD4_Pin LD1_Pin
                           eINC_DAT_CMD_Pin */
  GPIO_InitStruct.Pin = LD3_Pin|LD2_Pin|LD4_Pin|LD1_Pin
                          |eINC_DAT_CMD_Pin;
  GPIO_InitStruct.Mode = GPIO_MODE_OUTPUT_PP;
  GPIO_InitStruct.Pull = GPIO_NOPULL;
  GPIO_InitStruct.Speed = GPIO_SPEED_FREQ_LOW;
  HAL_GPIO_Init(GPIOK, &GPIO_InitStruct);

  /*Configure GPIO pin : eINK_RST_Pin */
  GPIO_InitStruct.Pin = eINK_RST_Pin;
  GPIO_InitStruct.Mode = GPIO_MODE_OUTPUT_PP;
  GPIO_InitStruct.Pull = GPIO_NOPULL;
  GPIO_InitStruct.Speed = GPIO_SPEED_FREQ_LOW;
  HAL_GPIO_Init(eINK_RST_GPIO_Port, &GPIO_InitStruct);

  /*Configure GPIO pin : B3_Pin */
  GPIO_InitStruct.Pin = B3_Pin;
  GPIO_InitStruct.Mode = GPIO_MODE_INPUT;
  GPIO_InitStruct.Pull = GPIO_NOPULL;
  HAL_GPIO_Init(B3_GPIO_Port, &GPIO_InitStruct);

  /*Configure GPIO pin : MCO1_Pin */
  GPIO_InitStruct.Pin = MCO1_Pin;
  GPIO_InitStruct.Mode = GPIO_MODE_AF_PP;
  GPIO_InitStruct.Pull = GPIO_NOPULL;
  GPIO_InitStruct.Speed = GPIO_SPEED_FREQ_LOW;
  GPIO_InitStruct.Alternate = GPIO_AF0_MCO;
  HAL_GPIO_Init(MCO1_GPIO_Port, &GPIO_InitStruct);

  /*Configure GPIO pin : eINK_BUSY_Pin */
  GPIO_InitStruct.Pin = eINK_BUSY_Pin;
  GPIO_InitStruct.Mode = GPIO_MODE_OUTPUT_PP;
  GPIO_InitStruct.Pull = GPIO_NOPULL;
  GPIO_InitStruct.Speed = GPIO_SPEED_FREQ_LOW;
  HAL_GPIO_Init(eINK_BUSY_GPIO_Port, &GPIO_InitStruct);

}

void StartDefaultTask(void *argument)
{
  for(;;)
  {
    osDelay(1);
  }
}

 /**
  * @brief  Period elapsed callback in non blocking mode
  * @note   This function is called  when TIM1 interrupt took place, inside
  * HAL_TIM_IRQHandler(). It makes a direct call to HAL_IncTick() to increment
  * a global variable "uwTick" used as application time base.
  * @param  htim : TIM handle
  * @retval None
  */
void HAL_TIM_PeriodElapsedCallback(TIM_HandleTypeDef *htim)
{
  if (htim->Instance == TIM1) {
    HAL_IncTick();
  }
}

void Error_Handler(void)
{
}

/************************ (C) COPYRIGHT STMicroelectronics *****END OF FILE****/
